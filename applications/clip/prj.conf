## CMakeLists.txt
```
# SPDX-License-Identifier: Apache-2.0

cmake_minimum_required(VERSION 3.20)

find_package(Zephyr REQUIRED HINTS $ENV{ZEPHYR_BASE})
project(clip)

# Include directories
target_include_directories(app PRIVATE include)

# Source files
target_sources(app PRIVATE
    src/main.c
    src/clip_event.c
    src/config.c
    src/ble.c
    src/transport.c
    src/transport_ble.c
    src/at_server.c
    src/at_commands.c
    src/audio.c
    src/storage.c
    src/transfer.c
    src/rtc_stream.c
    src/haptic.c
    src/button.c
    src/display.c
    src/icons.c
    src/wifi.c
    src/wifi_udp.c
    src/transport_udp.c
    src/battery.c
    src/usb_cdc.c
)
```

## Kconfig
```
#
# Copyright (c) 2025 Seeed Technology Co., Ltd.
#
# SPDX-License-Identifier: Apache-2.0
#

source "Kconfig.zephyr"

# Main application
menuconfig CLIP
	bool "Clip Application"
	default y

if CLIP

module = CLIP
module-str = Clip Application
source "subsys/logging/Kconfig.template.log_config"

# =============================================================================
# Configuration Defaults
# =============================================================================

config CLIP_NORMAL_BITRATE
	int "Normal mode Opus bitrate (bps)"
	default 32000

config CLIP_NORMAL_COMPLEXITY
	int "Normal mode Opus complexity (0-10)"
	range 0 10
	default 1

config CLIP_ENHANCED_BITRATE
	int "Enhanced mode Opus bitrate (bps)"
	default 32000

config CLIP_ENHANCED_COMPLEXITY
	int "Enhanced mode Opus complexity (0-10)"
	range 0 10
	default 1

config CLIP_DEFAULT_NOISE
	int "Default noise suppression level (dB)"
	default 12

config CLIP_DEFAULT_DEREVERB
	bool "Default dereverberation enabled"
	default y

config CLIP_AGC_MAX_GAIN
	int "AGC maximum gain (dB)"
	default 60

config CLIP_AGC_TARGET
	int "AGC target level"
	default 30000

config CLIP_AGC_INCREMENT
	int "AGC max increase (dB/s)"
	default 60

config CLIP_AGC_DECREMENT
	int "AGC max decrease (dB/s)"
	default -100

config CLIP_STORAGE_FULL_PERCENT
	int "SD usage percent at which recording is refused (storage full)"
	default 95
	range 50 99
	help
	  Recording is refused and a "Storage Full" error is shown when SD card
	  usage reaches this percentage (e.g. 95 = refuse at 95% full).

config CLIP_LOG_FS_DEFAULT_ON
	bool "Enable FS (SD card) log backend by default at boot"
	default y if LOG_BACKEND_UART
	help
	  FS log default follows the UART log backend: debug builds (which keep
	  UART logging) default FS log on (INF to /SD:/LOG); the production
	  snippet disables UART logging, so FS log defaults off there. The FS
	  log can still be toggled at runtime with AT+LOG=off|info|debug.
	  Coupling to LOG_BACKEND_UART (rather than overriding this symbol from
	  the production snippet) avoids broadcasting an app-only Kconfig symbol
	  into the mcuboot sysbuild image, where it is undefined.

config CLIP_DEFAULT_AUTODEL
	int "Default auto-delete days (-1 for off)"
	default -1

config CLIP_DEFAULT_BRIGHTNESS
	int "Default OLED brightness (0-255)"
	default 32

config CLIP_DISPLAY_STATUS_TIMEOUT_MS
	int "Status bar display timeout (ms)"
	default 10000

config CLIP_DISPLAY_PAIRING_TIMEOUT_MS
	int "Pairing guide display timeout (ms)"
	default 60000

config CLIP_DISPLAY_REC_TIMEOUT_MS
	int "Recording dot display timeout (ms)"
	default 30000
	help
	  Time the stable recording-dot screen stays on after entering
	  the REC_DOT state before the display blanks to save power.
	  Recording continues; any state-changing UI event (button
	  mark, stop, pause, ...) resumes the display.

config CLIP_SETTINGS_LOAD_TIMEOUT_MS
	int "settings_load watchdog timeout (ms)"
	default 3000

config CLIP_SD_IDLE_DELAY_MS
	int "SD card idle power-off delay (ms)"
	default 20000

config CLIP_ADV_FAST_TIMEOUT_MS
	int "BLE fast advertising timeout before dropping to slow (ms)"
	default 30000

config CLIP_WIFI_AP_CHANNEL
	int "Default WiFi AP channel (5GHz: 36-165)"
	default 36

config CLIP_WIFI_AP_REG_DOMAIN
	string "Default WiFi regulatory domain (2-letter country code)"
	default "US"

# =============================================================================
# Hardware Configuration (crystal caps, low-battery boot gate)
# =============================================================================

config CLIP_HFXO_CAPVALUE
	int "HFXO (32 MHz) crystal capacitance (raw XOSC32MCAPS.CAPVALUE)"
	default 60
	help
	  Raw CAPVALUE register field for the 32 MHz crystal internal load caps.
	  Set by clip_xo_cap_init() (SYS_INIT POST_KERNEL) — the HFXO DTS binding
	  can't take a raw CAPVALUE (it derives from FICR), so we override here.
	  Tune with the tests/clip "hfxo set" shell, then set here.

config CLIP_LFXO_INTCAP
	int "LFXO (32.768 kHz) internal capacitance (0=ext, 1=6pF, 2=7pF, 3=9pF)"
	range 0 3
	default 1
	help
	  INTCAP for the 32.768 kHz crystal (XOSC32KI.INTCAP). 0 = external caps,
	  1 = 6 pF, 2 = 7 pF, 3 = 9 pF internal. Set by clip_xo_cap_init().

# =============================================================================
# Button Configuration
# =============================================================================

# =============================================================================
# Haptic Motor Configuration
# =============================================================================

config CLIP_HAPTIC_MOTOR_ENABLED
	bool "Enable haptic motor"
	default n

config CLIP_HAPTIC_MOTOR_GPIO_PIN
	int "Haptic motor GPIO pin"
	default 6

# =============================================================================
# AT Server Configuration
# =============================================================================

config CLIP_AT_SERVER_QUEUE_SIZE
	int "AT command queue size"
	default 10

config CLIP_AT_SERVER_STACK_SIZE
	int "AT server thread stack size"
	default 4096

config CLIP_AT_SERVER_PRIORITY
	int "AT server thread priority"
	default 7

config CLIP_AT_MAX_CMD_LEN
	int "Maximum AT command length"
	default 256

config CLIP_AT_MAX_RESPONSE_LEN
	int "Maximum AT response length"
	default 1024

# =============================================================================
# Audio Configuration
# =============================================================================

config CLIP_AUDIO_STACK_SIZE
	int "Audio thread stack size"
	default 32768

config CLIP_AUDIO_THREAD_PRIORITY
	int "Audio thread priority"
	default 0

config CLIP_AUDIO_ENABLED
	bool "Enable audio recording"
	default y

config CLIP_AUDIO_DMIC_FLUSH_FRAMES
	int "Number of DMIC frames to discard on start/resume"
	range 0 20
	default 4
	help
	  Number of 20ms DMIC frames to discard after mic power-on
	  to eliminate pop/click from power-up transients.

# =============================================================================
# Storage Configuration
# =============================================================================

config CLIP_STORAGE_ENABLED
	bool "Enable SD card storage"
	default y

config CLIP_STORAGE_MAX_SESSIONS
	int "Maximum number of sessions to list"
	default 100

config CLIP_STORAGE_SESSIONS_PER_PAGE
	int "Sessions per page for LIST command"
	default 20

config CLIP_STORAGE_MAX_CHUNKS
	int "Maximum chunks per session"
	default 9999

config CLIP_STORAGE_CHUNK_SIZE
	int "Storage chunk buffer size (bytes)"
	default 4096

config CLIP_STORAGE_FILES_PER_GROUP
	int "Number of files per group subdirectory"
	default 100
	help
	  Maximum number of audio files stored in each group subdirectory.
	  When a session has many files, they are organized into
	  subdirectories (0, 1, 2...) to maintain FAT filesystem performance.
	  Group = (file_index - 1) / FILES_PER_GROUP.

# =============================================================================
# Audio Segment Configuration
# =============================================================================

config CLIP_AUDIO_SEGMENT_DURATION_SYNC
	int "Audio segment duration during sync (seconds)"
	range 10 600
	default 60

config CLIP_AUDIO_SEGMENT_DURATION_NO_SYNC
	int "Audio segment duration without sync (seconds)"
	range 20 3600
	default 300

# =============================================================================
# Transfer Configuration
# =============================================================================

config CLIP_TRANSFER_ENABLED
	bool "Enable file transfer"
	default y

config CLIP_TRANSFER_STACK_SIZE
	int "Transfer thread stack size"
	default 16384

config CLIP_TRANSFER_THREAD_PRIORITY
	int "Transfer thread priority"
	default 5

config CLIP_TRANSFER_CHUNK_SIZE
	int "Transfer chunk size (bytes)"
	default 4096
	help
	  Data chunk size for file transfer. Transport layer slices into
	  multiple frames as needed (UDP max frame is 1024 bytes).
	  BLE transport will split into multiple notifications automatically.

# =============================================================================
# UDP Transport Configuration
# =============================================================================

config CLIP_UDP_THREAD_STACK_SIZE
	int "UDP server thread stack size"
	default 4096

config CLIP_UDP_THREAD_PRIORITY
	int "UDP server thread priority"
	default 5

config CLIP_UDP_RECV_BUF_SIZE
	int "UDP receive buffer size"
	default 2048

config CLIP_UDP_SOCKET_BUF_SIZE
	int "UDP socket SO_RCVBUF/SO_SNDBUF size"
	default 4096

config CLIP_UDP_MAX_DATA_SIZE
	int "UDP maximum data per packet"
	default 1024

config CLIP_UDP_HEARTBEAT_INTERVAL_MS
	int "UDP heartbeat interval (ms)"
	default 5000

config CLIP_UDP_CONNECTION_TIMEOUT_MS
	int "UDP connection timeout (ms)"
	default 30000

config CLIP_UDP_SEND_BACKOFF_US
	int "UDP send-error backoff (us), 0 to disable"
	default 1000
	help
	  Delay after a UDP sendto failure before the next frame. Only fires on an
	  actual send error (the socket is blocking, so this is rare), as a brief
	  drain window. 0 disables.

config CLIP_UDP_FILE_END_DELAY_US
	int "UDP delay before FILE_END (us), 0 to disable"
	default 5000
	help
	  Pause after the last DATA frame and before sending FILE_END. UDP is
	  unordered, so FILE_END sent right after the last DATA can overtake it
	  and make the client compute the file CRC before all DATA arrives (NACK).
	  Lets in-flight DATA land first. 0 disables.

config CLIP_UDP_REPAIR_PACE_US
	int "UDP inter-frame pace during retransmit (us), 0 to disable"
	default 1000
	help
	  Delay between retransmitted DATA frames when repairing a NACKed file
	  (selective repeat OR whole-file). The link just dropped frames, so pacing
	  the retransmit avoids re-overwhelming it. Halves each repair round (递减)
	  toward full speed as the file converges; the next file's initial send is
	  always full speed. 0 disables.

config CLIP_UDP_NACK_BACKOFF_MS
	int "UDP backoff between NACK retry rounds (ms)"
	default 10
	help
	  Delay before each NACK retransmit round, multiplied by the retry number
	  (10 ms, 20 ms, 30 ms ...). Lets the WiFi channel settle before resending.
	  Was 50; lowered — the heartbeat keep-alive makes the link stable, so a
	  long backoff just slows recovery.

# =============================================================================
# WiFi Configuration
# =============================================================================

config CLIP_WIFI_TIMEOUT_MS
	int "WiFi AP auto-off timeout (ms), 0 to disable"
	default 60000
	help
	  Time in milliseconds before WiFi AP is automatically disabled.
	  Timer starts after AP is enabled, restarts on client disconnect.
	  Set to 0 to disable auto-off.

config COEX_SEP_ANTENNAS
	bool "WiFi and BLE use separate antennas"
	default n

config SR_PROTOCOL_BLE
	bool "Short Range protocol is Bluetooth LE"
	default y
	help
	  Tells the WiFi/BLE coexistence PTA that the short-range
	  protocol is BLE, enabling proper radio arbitration.

# =============================================================================
# Battery / Fuel-Gauge Configuration
# =============================================================================

config CLIP_BATTERY_WIFI_LOAD_COMPENSATION
	bool "Compensate fuel gauge for WiFi (nRF70) current the NPM1300 IBAT cannot see"
	default y
	help
	  The nRF7002 main VDD (BUCKVBAT) is tied to VBAT upstream of the NPM1300,
	  so its radio TX/RX/internal-buck current never flows through the PMIC's
	  IBAT sense resistor. GAUGE_AVG_CURRENT therefore undercounts discharge
	  (and over-counts charge while charging) whenever WiFi is on, so the fuel
	  gauge SoC reads high. Fold a state-keyed WiFi-load estimate into the
	  current fed to nrf_fuel_gauge_process() to cancel the blind spot, in both
	  charge and discharge states. Disable only for an uncompensated baseline.

config CLIP_BATTERY_WIFI_AP_LOAD_MA
	int "Measured unseen nRF70 current with AP up, idle (mA)"
	default 59
	help
	  nRF7002 current (mA) drawn from VBAT-direct while the WiFi AP is up
	  but no file transfer is active (beaconing + radio standby). This is a
	  REAL draw the NPM1300 IBAT cannot see, so it must be billed to the
	  fuel gauge. Calibrate on the VBAT rail (upstream of the NPM1300):
	  unseen = total - |IBAT| with the AP up.

config CLIP_BATTERY_WIFI_TX_LOAD_MA
	int "Measured unseen nRF70 current during active UDP transfer (mA)"
	default 99
	help
	  nRF7002 current (mA) drawn from VBAT-direct while a WiFi UDP file
	  transfer is active (AP up + transfer). Calibrate the same way as
	  CLIP_BATTERY_WIFI_AP_LOAD_MA during an active transfer.

config CLIP_BATTERY_IDLE_CURRENT_UA
	int "Average battery current while idle, fed to the fuel gauge (uA)"
	default 400
	help
	  At idle the PMIC's one-shot IBAT sample is taken while the CPU runs the
	  60 s poll itself (mA-level draw, ~1.09 mA LSB) and integrating that
	  single sample over the whole 60 s delta over-counts discharge (~3%/h
	  phantom). Nordic's guidance for low-power periods is that the idle
	  current is known ahead of time: when not charging/recording/
	  transferring, this value is fed to nrf_fuel_gauge_process instead of
	  the measurement (and passed to nrf_fuel_gauge_idle_set). Calibrate from
	  the idle power budget (production ~170 uA + BLE advertising + OLED
	  wakeups).

config CLIP_BATTERY_DISPLAY_MAX_STEP
	int "Max displayed SoC change per poll (%)"
	default 3
	help
	  Rate-limits the DISPLAYED state-of-charge toward the fuel-gauge value,
	  DIRECTIONALLY, polled every 60 s: while charging the display only moves
	  UP toward the gauge (catch up + track the charge); while discharging it
	  only moves DOWN (track depletion). A normal charge/discharge changes by
	  <= MAX_STEP per poll, so the display tracks it with ZERO lag. The gauge's
	  voltage-reconciliation up-correction (the ~5-15% first-reboot jump after
	  charge/discharge cycling) is therefore held while discharging (no upward
	  creep on a discharging battery) and only corrected on the next charge.
	  Set 0 to disable smoothing (display the raw gauge SoC directly). The
	  displayed value is persisted across reboot so it resumes from the value
	  shown before reboot (no cross-reboot lag accumulation).

# =============================================================================
# Debug Configuration
# =============================================================================

config CLIP_DEBUG_STATS
	bool "Enable periodic thread stack and heap usage logging"
	default n
	help
	  Print thread stack usage and heap stats every 10 seconds.

endif # CLIP
```

## Kconfig.sysbuild
```
#
# Copyright (c) 2025 Seeed Technology Co., Ltd.
#
# SPDX-License-Identifier: Apache-2.0
#

source "${ZEPHYR_BASE}/share/sysbuild/Kconfig"

# Enable Network Core IPC Radio for BLE
config NRF_DEFAULT_IPC_RADIO
	default y

config NETCORE_IPC_RADIO_BT_HCI_IPC
	default y
```

## sample.yaml
```
# SPDX-License-Identifier: Apache-2.0
sample:
  description: ReSpeaker Clip - Voice recording device with BLE AT command control, dual-core OTA DFU support
  name: ReSpeaker Clip Application with Dual-Core DFU

common:
  sysbuild: true
  build_only: true
  integration_platforms:
    - clip/nrf5340/cpuapp
  platform_allow:
    - clip/nrf5340/cpuapp

tests:
  clip.app: {}
```

## sysbuild.conf
```
# SPDX-License-Identifier: Apache-2.0
#
# sysbuild.conf - System build configuration for dual-core MCUboot DFU
#
# This configuration enables OTA updates for both application core and network core
# using external SPI Flash (PY25Q64H 64MB on SPI3)

# Enable MCUboot bootloader
SB_CONFIG_BOOTLOADER_MCUBOOT=y

# Configure project to use external SPI flash for DFU secondary partition
# The external flash (PY25Q64H) is connected via SPI3, not QSPI
SB_CONFIG_PM_EXTERNAL_FLASH_MCUBOOT_SECONDARY=y
# For SPI flash, override external driver check is required
SB_CONFIG_PM_OVERRIDE_EXTERNAL_DRIVER_CHECK=y

# Add network core (b0n) image for secure boot
SB_CONFIG_SECURE_BOOT_NETCORE=y

# Set up multiple partitions for dual-core update
SB_CONFIG_MCUBOOT_UPDATEABLE_IMAGES=2

# Add support to netcore for DFU
SB_CONFIG_NETCORE_APP_UPDATE=y

# Add support to mcuboot for updating two cores simultaneously
SB_CONFIG_MCUBOOT_NRF53_MULTI_IMAGE_UPDATE=y

# Simultaneous FOTA does not support rollback (overwrite-only mode)
SB_CONFIG_MCUBOOT_MODE_OVERWRITE_ONLY=y
```

## prj.conf
```kconfig
# SPDX-License-Identifier: Apache-2.0
#
# Clip Application Configuration
# Refactored version with modular architecture
#

# ==============================================================================
# FPU + CMSIS-DSP
# ==============================================================================
CONFIG_FPU=y
CONFIG_FPU_SHARING=y
CONFIG_CMSIS_DSP=y

# ==============================================================================
# Logging Configuration
# ==============================================================================
CONFIG_LOG=y
CONFIG_ASSERT=n
# DBG compiled so AT+LOG=debug actually emits debug records. Production keeps
# the FS backend off by default, so this costs flash but no file/I/O until the
# user enables AT+LOG=debug. Per-module WRN demotions still keep the common
# boot log concise.
CONFIG_CLIP_LOG_LEVEL_DBG=y
# No live code prints %f (the old battery DBG %.3f was replaced with integer
# mV/mA); keep cbprintf FP support off to save flash.
CONFIG_CBPRINTF_FP_SUPPORT=n
CONFIG_LOG_DEFAULT_LEVEL=0
CONFIG_LOG_MODE_DEFERRED=y
CONFIG_LOG_RUNTIME_FILTERING=y
CONFIG_LOG_BUFFER_SIZE=8192
CONFIG_LOG_PROCESS_THREAD=y

# FS log backend (SD card /SD:/LOG/)
CONFIG_LOG_BACKEND_FS=y
CONFIG_LOG_BACKEND_FS_DIR="/SD:/LOG"
CONFIG_LOG_BACKEND_FS_FILE_PREFIX="log."
CONFIG_LOG_BACKEND_FS_FILE_SIZE=131072
CONFIG_LOG_BACKEND_FS_FILES_LIMIT=20
CONFIG_LOG_BACKEND_FS_OVERWRITE=y
CONFIG_LOG_BACKEND_FS_APPEND_TO_NEWEST_FILE=y

# Minimize log output overhead
CONFIG_LOG_BACKEND_SHOW_COLOR=n
CONFIG_LOG_PRINTK=n

# Disable validation features to save flash
CONFIG_SPIN_VALIDATE=n
CONFIG_MEM_SLAB_POINTER_VALIDATE=n

# ==============================================================================
# Main Stack and Heap
# ==============================================================================
CONFIG_MAIN_STACK_SIZE=6144
# 70912: was 77824; cut for the WiFi worker stack, SN buffers, storage GC,
# statics, the shutdown failsafe thread stack, and the settings probe
# statics (RAM headroom for the GC work/mutexes).
CONFIG_HEAP_MEM_POOL_SIZE=70912
CONFIG_CLIP_AT_SERVER_STACK_SIZE=8192
CONFIG_CLIP_TRANSFER_STACK_SIZE=4096
CONFIG_CLIP_UDP_THREAD_STACK_SIZE=2048

# ==============================================================================
# Reboot Support
# ==============================================================================
CONFIG_REBOOT=y

# ==============================================================================
# Power Management (System ON Idle)
# ==============================================================================
CONFIG_PM=y
CONFIG_PM_DEVICE=y
CONFIG_PM_DEVICE_RUNTIME=y
CONFIG_TICKLESS_KERNEL=y

# ==============================================================================
# Thread Monitoring (disabled to save ~20KB flash)
# ==============================================================================
CONFIG_THREAD_MONITOR=n
CONFIG_THREAD_NAME=n
CONFIG_THREAD_RUNTIME_STATS=n
CONFIG_THREAD_RUNTIME_STATS_USE_TIMING_FUNCTIONS=n
CONFIG_INIT_STACKS=n
CONFIG_STACK_SENTINEL=n
CONFIG_SYS_HEAP_RUNTIME_STATS=n

# DWT cycle counter for precise timing measurement
CONFIG_CORTEX_M_DWT=y

# Debug stats (thread stack + heap usage)
CONFIG_CLIP_DEBUG_STATS=n

# ==============================================================================
# Retention subsystem for MCUboot USB DFU mode trigger
# ==============================================================================
CONFIG_RETAINED_MEM=y
CONFIG_RETENTION=y
CONFIG_RETENTION_BOOT_MODE=y

# ==============================================================================
# Bluetooth BLE Configuration (minimal for OTA)
# ==============================================================================
CONFIG_BT=y
CONFIG_BT_PERIPHERAL=y
CONFIG_BT_DEVICE_NAME="Clip"
CONFIG_BT_DEVICE_NAME_DYNAMIC=y
CONFIG_BT_MAX_CONN=1

# BLE throughput optimization
CONFIG_BT_BUF_ACL_RX_SIZE=517
CONFIG_BT_BUF_ACL_TX_SIZE=517
CONFIG_BT_L2CAP_TX_MTU=517
CONFIG_BT_GATT_CLIENT=y
CONFIG_BT_RX_STACK_SIZE=4096

# BLE Pairing & Bonding
CONFIG_BT_SMP=y
CONFIG_BT_BONDABLE=y
CONFIG_BT_MAX_PAIRED=1
# Debug: a new phone may pair and overwrite the single stored bond without
# first clearing it (convenient for testing). Production turns this OFF in
# snippets/production/snippet-production.conf so the device stays locked to
# its owner until an explicit AT+PAIR=reset.
CONFIG_BT_KEYS_OVERWRITE_OLDEST=y
CONFIG_BT_SETTINGS=y
CONFIG_BT_FILTER_ACCEPT_LIST=y
CONFIG_BT_GATT_SERVICE_CHANGED=y
CONFIG_BT_GATT_CACHING=y
CONFIG_BT_ASSERT_VERBOSE=n

# ==============================================================================
# GPIO and Regulators
# ==============================================================================
CONFIG_GPIO=y
CONFIG_REGULATOR=y

# Custom GPIO button driver
CONFIG_GPIO_BUTTON=y
CONFIG_INPUT_GPIO_BUTTON_OWN_THREAD=y
CONFIG_INPUT_GPIO_BUTTON_THREAD_STACK_SIZE=512
CONFIG_INPUT_GPIO_BUTTON_THREAD_PRIORITY=5

# Haptic motor control
CONFIG_CLIP_HAPTIC_MOTOR_ENABLED=y

# Display
CONFIG_DISPLAY=y

# I2C for PMIC and Display
CONFIG_I2C=y

# MFD and npm1300 charger/fuel-gauge sensor (required for SD card power)
CONFIG_MFD=y
CONFIG_SENSOR=y
CONFIG_NPM13XX_CHARGER=y

# Nordic nRF Fuel Gauge Library for accurate battery SoC estimation
CONFIG_NRF_FUEL_GAUGE=y
CONFIG_NRF_FUEL_GAUGE_VARIANT_SECONDARY_CELL=y

# BLE Battery Service
CONFIG_BT_BAS=y
CONFIG_BT_BAS_BLS=y
CONFIG_BT_BAS_BLS_BATTERY_LEVEL_PRESENT=y
CONFIG_BT_BAS_BLS_ADDITIONAL_STATUS_PRESENT=y

# ==============================================================================
# Settings and Storage
# ==============================================================================
CONFIG_FLASH=y
CONFIG_FLASH_MAP=y
CONFIG_SETTINGS=y

# File Systems
CONFIG_FILE_SYSTEM=y

# LittleFS for settings
CONFIG_FILE_SYSTEM_LITTLEFS=y
CONFIG_FS_LITTLEFS_FMP_DEV=y
CONFIG_FS_LITTLEFS_FC_HEAP_SIZE=4096
CONFIG_FS_LITTLEFS_NUM_FILES=16
CONFIG_FS_LITTLEFS_NUM_DIRS=4

# FATFS for SD card
CONFIG_FAT_FILESYSTEM_ELM=y
CONFIG_FS_FATFS_LFN=y
CONFIG_FS_FATFS_LFN_MODE_HEAP=y
CONFIG_FS_FATFS_REENTRANT=y
CONFIG_DISK_ACCESS=y
CONFIG_DISK_DRIVER_SDMMC=y

CONFIG_SETTINGS_FILE=y
CONFIG_SETTINGS_FILE_PATH="/lfs/settings/run"
CONFIG_SETTINGS_FILE_MAX_LINES=16

# ==============================================================================
# Bluetooth OTA DFU (MCUmgr) - App core + Network core
# ==============================================================================
CONFIG_NCS_SAMPLE_MCUMGR_BT_OTA_DFU=y
CONFIG_MCUMGR_GRP_IMG_UPDATABLE_IMAGE_NUMBER=2
CONFIG_MCUMGR_MGMT_NOTIFICATION_HOOKS=y
CONFIG_MCUMGR_GRP_IMG_STATUS_HOOKS=y
CONFIG_MCUMGR_GRP_IMG_UPLOAD_CHECK_HOOK=y

CONFIG_SYSTEM_WORKQUEUE_STACK_SIZE=4096

CONFIG_NEWLIB_LIBC=y
CONFIG_NEWLIB_LIBC_NANO=y

# ==============================================================================
# Flash Size Optimization (-Oz)
# ==============================================================================
CONFIG_NO_OPTIMIZATIONS=n
CONFIG_DEBUG_OPTIMIZATIONS=n
CONFIG_SPEED_OPTIMIZATIONS=n
CONFIG_SIZE_OPTIMIZATIONS=n
CONFIG_SIZE_OPTIMIZATIONS_AGGRESSIVE=y

# Link Time Optimization
CONFIG_ISR_TABLES_LOCAL_DECLARATION=y
CONFIG_LTO=y

# ==============================================================================
# Audio Configuration (DMIC + Opus + SpeexDSP)
# ==============================================================================
CONFIG_CLIP_AUDIO_ENABLED=y

# DMIC (PDM Microphone)
CONFIG_AUDIO=y
CONFIG_AUDIO_DMIC=y

# Opus Codec
CONFIG_OPUS_CODEC=y

# SpeexDSP for audio preprocessing (noise suppression, AGC, dereverb)
# Only used in enhanced/merge mode, not in stereo mode
CONFIG_SPEEXDSP=y

# Thread stack for audio (needs more space for Opus encoding)
CONFIG_CLIP_AUDIO_STACK_SIZE=32768
CONFIG_CLIP_AUDIO_THREAD_PRIORITY=0

# =============================================================================
# Audio Segment Duration (configured via Kconfig, not hardcoded here)
# Use CLIP_AUDIO_SEGMENT_DURATION_SYNC and CLIP_AUDIO_SEGMENT_DURATION_NO_SYNC
# from Kconfig to set these values (default: 60s and 300s)
# =============================================================================
CONFIG_CLIP_AUDIO_SEGMENT_DURATION_SYNC=60
CONFIG_CLIP_AUDIO_SEGMENT_DURATION_NO_SYNC=300

CONFIG_CLIP_STORAGE_FILES_PER_GROUP=100

# ==============================================================================
# WiFi AP Configuration
# ==============================================================================
# nRF7002 firmware patches stored on external SPI flash (saves ~87KB internal)
# ==============================================================================
CONFIG_WIFI=y
CONFIG_WIFI_NRF70=y
CONFIG_NRF70_AP_MODE=y

# WiFi/BLE coexistence: MPSL_CX=y on net core + NRF70_SR_COEX=y on app core.
# NRF70_SR_COEX_RF_SWITCH is NOT enabled (no RF switch hardware on this board).
CONFIG_NRF70_SR_COEX=y
CONFIG_WIFI_NM_WPA_SUPPLICANT=y
CONFIG_WIFI_NM_WPA_SUPPLICANT_AP=y
# Suppress WPA supplicant log strings (saves ~10KB flash)
CONFIG_WIFI_NM_WPA_SUPPLICANT_LOG_LEVEL_ERR=y
# Disable WPA3/SAE — device uses WPA2-PSK only (saves ~23KB flash)
CONFIG_WIFI_NM_WPA_SUPPLICANT_WPA3_IMPLEMENTATION_NONE=y

# AP-only mode — STA infrastructure required by AP code, cannot disable
# CONFIG_NRF70_STA_MODE=n

# Crypto: SHA512/DHM disable caused sta_set_flags errors, keep enabled for now
# CONFIG_MBEDTLS_SHA512_C=n
# CONFIG_MBEDTLS_SHA384_C=n
# CONFIG_MBEDTLS_DHM_C=n
CONFIG_WIFI_RANDOM_MAC_ADDRESS=y

# WiFi ready callback library (for runtime net_if_up)
CONFIG_WIFI_READY_LIB=y

# WiFi driver manual start (user must call net_if_up before AP mode)
# This saves ~30mA when WiFi is not in use.
CONFIG_NRF_WIFI_IF_AUTO_START=n

# QSPI low power mode (saves ~0.1-0.3mA when WiFi is off)
CONFIG_NRF70_QSPI_LOW_POWER=y

# Minimal networking stack (IPv4 + UDP + DHCP, no IPv6/TCP)
CONFIG_NETWORKING=y
CONFIG_NET_L2_ETHERNET=y
CONFIG_NET_L2_WIFI_MGMT=y
CONFIG_NET_IPV4=y
CONFIG_NET_IPV6=n
CONFIG_NET_UDP=y
CONFIG_NET_TCP=n
CONFIG_NET_SOCKETS=y
CONFIG_NET_DHCPV4=y
CONFIG_NET_DHCPV4_SERVER=y
CONFIG_NET_DHCPV4_SERVER_ADDR_COUNT=1
CONFIG_NET_MGMT=y
CONFIG_NET_MGMT_EVENT=y
CONFIG_NET_CONFIG_SETTINGS=y
CONFIG_NET_CONFIG_INIT_TIMEOUT=0
CONFIG_NET_LOG=n

# AP static IP
CONFIG_NET_IF_UNICAST_IPV4_ADDR_COUNT=1
CONFIG_NET_CONFIG_MY_IPV4_ADDR="192.168.4.1"
CONFIG_NET_CONFIG_MY_IPV4_NETMASK="255.255.255.0"
CONFIG_NET_CONFIG_MY_IPV4_GW="192.168.4.1"

CONFIG_MBEDTLS_HEAP_SIZE=1024


# Minimal WiFi buffer sizes (tune for RAM/flash balance)
CONFIG_NET_PKT_RX_COUNT=8
CONFIG_NET_PKT_TX_COUNT=24
CONFIG_NET_BUF_RX_COUNT=16
CONFIG_NET_BUF_TX_COUNT=32
CONFIG_NET_PKT_BUF_TX_DATA_POOL_SIZE=16384
CONFIG_CLIP_UDP_SOCKET_BUF_SIZE=4096
CONFIG_NRF70_RX_NUM_BUFS=8
CONFIG_NRF70_MAX_TX_AGGREGATION=4
CONFIG_NRF_WIFI_CTRL_HEAP_SIZE=20000
CONFIG_NRF_WIFI_DATA_HEAP_SIZE=40000

CONFIG_NET_TC_TX_COUNT=1
CONFIG_NET_IF_UNICAST_IPV4_ADDR_COUNT=1
CONFIG_NET_MAX_CONTEXTS=8
CONFIG_NET_MAX_CONN=6
CONFIG_NET_CONTEXT_SYNC_RECV=y
CONFIG_NET_CONFIG_SETTINGS=y
CONFIG_NET_CONFIG_INIT_TIMEOUT=0
CONFIG_NET_SOCKETS_POLL_MAX=4
CONFIG_NET_TCP_TIME_WAIT_DELAY=0
CONFIG_NET_TCP_WORKQ_STACK_SIZE=2048

CONFIG_NET_RX_STACK_SIZE=2048
CONFIG_NET_TX_STACK_SIZE=2048

CONFIG_NRF70_IRQ_WQ_STACK_SIZE=1024

CONFIG_WIFI_NM_WPA_SUPPLICANT_THREAD_STACK_SIZE=10240
CONFIG_WIFI_NM_WPA_SUPPLICANT_WQ_STACK_SIZE=2048

# Required by WPA supplicant
CONFIG_POSIX_TIMERS=y
CONFIG_ENTROPY_GENERATOR=y

# Hardware info for SSID generation from chip ID
CONFIG_HWINFO=y

# ==============================================================================
# USB - CDC ACM (AT command serial) + MSC (SD card, on demand)
# ==============================================================================
CONFIG_USB_DEVICE_STACK_NEXT=y

# 1200-baud USB CDC -> mcuboot DFU trigger (hook is on via the board default
# CONFIG_CLIP_USB_DFU=y). The clip app brings its own BLE-gated CDC+MSC, so
# disable the module's default CDC (which is for apps without a USB stack).
CONFIG_CLIP_USB_DFU_DEFAULT_CDC=n

# CDC ACM (virtual serial port for AT commands)
CONFIG_USBD_CDC_ACM_CLASS=y
CONFIG_SERIAL=y
CONFIG_UART_INTERRUPT_DRIVEN=y
CONFIG_UART_LINE_CTRL=y

# MSC (Mass Storage, enabled via AT+MSC=on)
CONFIG_USBD_MSC_CLASS=y
CONFIG_USBD_MSC_LUNS_PER_INSTANCE=1
CONFIG_USBD_MSC_DOUBLE_BUFFERING=n
CONFIG_USBD_MSC_SCSI_BUFFER_SIZE=512
CONFIG_USBD_MSC_STACK_SIZE=1024

# ==============================================================================
# Flash partitioning
# ==============================================================================
# LittleFS lives on the external SPI NOR (partition lfs_storage, mounted at
# /lfs by config.c). NCS defaults CONFIG_PM_PARTITION_SIZE_LITTLEFS to 24 KB,
# which makes the partition manager carve an *unused* littlefs_storage region
# out of the end of internal flash (0xfa000-0x100000) and shrink the app slot
# from the intended 0xE9E00 to 0xE3E00. Zero it here (app image only — the
# bootloader does not enable LittleFS and must not see this symbol), so the
# static layout in pm_static_clip_nrf5340_cpuapp.yml applies.
CONFIG_PM_PARTITION_SIZE_LITTLEFS=0
```

## boards/clip_nrf5340_cpuapp.overlay
```dts
/*
 * Copyright (c) 2025 Seeed Technology Co., Ltd.
 *
 * SPDX-License-Identifier: Apache-2.0
 */

/* Device tree overlay for reSpeaker Clip application */

/ {
    /* Reserved for future use - can add aliases or properties here */
};
```

## boards/clip_nrf5340_cpuapp_dev.overlay
```dts
/*
 * Copyright (c) 2025 Seeed Technology Co., Ltd.
 *
 * SPDX-License-Identifier: Apache-2.0
 */

/*
 * Development-environment variant of clip_nrf5340_cpuapp.overlay, selected
 * when building with -DFILE_SUFFIX=dev. FILE_SUFFIX semantics: the suffixed
 * file REPLACES the base file, so keep this in sync with
 * clip_nrf5340_cpuapp.overlay!
 *
 * Adds: console (and with it the UART log backend, printk, fault output)
 * redirected from uart0 to the app's USB CDC ACM port, so users without a
 * J-Link / UART adapter can watch logs over USB.
 *
 * Trade-offs (accepted for a debug convenience build):
 * - Messages printed before USB enumeration completes are lost (the CDC
 *   port is not connected yet); runtime logging is unaffected.
 * - hw-flow-control is intentionally NOT enabled on cdc_acm_uart: with it,
 *   cdc_acm poll_out blocks forever while no host is reading, which would
 *   hang boot on a charger-only port. Without it, a slow or absent host
 *   just drops console output.
 */

/ {
    chosen {
        zephyr,console = &cdc_acm_uart;
        zephyr,shell-uart = &cdc_acm_uart;
    };
};

/* Enable display for UI module */
&ch1115 {
    status = "okay";
};

&i2c2 {
    status = "okay";
};
```

## src/main.c
```c
/*
 * Copyright (c) 2025 Seeed Technology Co., Ltd.
 *
 * SPDX-License-Identifier: Apache-2.0
 */

#include <zephyr/kernel.h>
#include <zephyr/logging/log.h>
#include <zephyr/logging/log_backend.h>
#include <zephyr/logging/log_ctrl.h>
#include <zephyr/drivers/regulator.h>
#include <app_version.h>
#include <zephyr/sys/util.h>
#include <zephyr/sys/mem_stats.h>
#include <zephyr/sys/sys_heap.h>

#include <nrfx_clock.h>
#include <hal/nrf_oscillators.h>

#include "clip.h"
#include "config.h"
#include "ble.h"
#include "transport.h"
#include "transport_ble.h"
#include "at_server.h"
#include "at_commands.h"
#include "audio.h"
#include "storage.h"
#include "transfer.h"
#include "button.h"
#include "display.h"
#include "wifi.h"
#include "wifi_udp.h"
#include "transport_udp.h"
#include "clip_event.h"
#include "battery.h"
#include "haptic.h"
#include "usb_cdc.h"
#include "rtc_stream.h"

LOG_MODULE_REGISTER(main, LOG_LEVEL_WRN); /* flash budget: INF kept for
 * battery/wifi/storage/button/audio */

/* Global context */
static struct clip_context g_ctx;

struct clip_context *clip_get_context(void)
{
    return &g_ctx;
}

const char *clip_state_to_string(enum clip_state state)
{
    switch (state) {
    case CLIP_STATE_UNINITIALIZED:
        return "UNINITIALIZED";
    case CLIP_STATE_IDLE:
        return "IDLE";
    case CLIP_STATE_RECORDING:
        return "RECORDING";
    case CLIP_STATE_TRANSMITTING:
        return "TRANSMITTING";
    case CLIP_STATE_WIFI_SYNC:
        return "WIFI_SYNC";
    case CLIP_STATE_PAUSED:
        return "PAUSED";
    case CLIP_STATE_ERROR:
        return "ERROR";
    case CLIP_STATE_OTA:
        return "OTA";
    default:
        return "UNKNOWN";
    }
}

bool clip_get_current_time(uint16_t *out_year, uint8_t *out_month, uint8_t *out_day,
                           uint8_t *out_hour, uint8_t *out_min, uint8_t *out_sec)
{
    uint32_t sec;

    if (!g_ctx.time.valid) {
        return false;
    }

    /* Calculate elapsed time since sync */
    int64_t current_uptime = k_uptime_get();
    int64_t elapsed_ms = current_uptime - g_ctx.time.base_uptime_ms;

    if (elapsed_ms < 0) {
        elapsed_ms = 0;
    }

    /* Convert to seconds */
    uint32_t elapsed_sec = (uint32_t)(elapsed_ms / 1000);

    /* Start from the FULL base time-of-day, not just the seconds field.
     * Adding elapsed only to g_ctx.time.sec (and then deriving hour/min from
     * the total) silently dropped the stored hour/min. After every
     * config_sync_time() rebase the next session id restarted near 00:0x,
     * and two recordings seconds apart could differ by many hours. */
    uint64_t day_sec = (uint64_t)g_ctx.time.hour * 3600U
                     + (uint64_t)g_ctx.time.min * 60U
                     + (uint64_t)g_ctx.time.sec
                     + elapsed_sec;
    uint32_t add_days = (uint32_t)(day_sec / 86400U);
    day_sec %= 86400U;

    uint16_t year = g_ctx.time.year;
    uint8_t month = g_ctx.time.month;
    uint32_t day = (uint32_t)g_ctx.time.day + add_days;

    uint8_t hour = (uint8_t)(day_sec / 3600U);
    uint8_t min = (uint8_t)((day_sec % 3600U) / 60U);
    sec = (uint32_t)(day_sec % 60U);

    /* Day overflow — recompute February for each year rollover */
    uint8_t days_in_month[] = {31, 28, 31, 30, 31, 30, 31, 31, 30, 31, 30, 31};
    if ((year % 4 == 0 && year % 100 != 0) || (year % 400 == 0)) {
        days_in_month[1] = 29;
    }

    while (day > days_in_month[month - 1]) {
        day -= days_in_month[month - 1];
        month++;
        if (month > 12) {
            month = 1;
            year++;
            days_in_month[1] =
                ((year % 4 == 0 && year % 100 != 0) || (year % 400 == 0)) ? 29 : 28;
        }
    }

    *out_year = year;
    *out_month = month;
    *out_day = (uint8_t)day;
    *out_hour = hour;
    *out_min = min;
    *out_sec = (uint8_t)sec;

    return true;
}

int clip_init(void)
{
    int err;


    /* Initialize context */

    /* Initialize configuration (will set defaults and load from storage) */
    err = config_init();
    if (err) {
        LOG_WRN("Config init failed: %d, using defaults", err);
        /* Continue anyway - config is optional */
    }

    /* Initialize battery monitoring before display so first render has real data */
    err = battery_init();
    if (err) {
        LOG_WRN("Battery init failed: %d", err);
        /* Continue anyway - battery is optional */
    }

    /* Initialize haptic motor before display (boot animation uses it) */
    err = haptic_init();
    if (err) {
        LOG_WRN("Haptic init failed: %d", err);
    }

    /* Initialize display early (before slow BLE init) to light up screen */
    err = display_init();
    if (err) {
        LOG_WRN("Display init failed: %d", err);
        /* Continue anyway - display is optional */
    }

    /* Start boot animation (runs in background while init continues) */
    display_boot_animation_start();

    /* Initialize BLE (bt_enable is slow, display is already showing) */
    err = ble_init();
    if (err) {
        LOG_ERR("BLE init failed: %d", err);
        return err;
    }

    /* Initialize transport layer */
    err = transport_init();
    if (err) {
        LOG_ERR("Transport init failed: %d", err);
        return err;
    }

    /* Initialize BLE transport (now that BLE is ready) */
    err = transport_ble_init();
    if (err) {
        LOG_ERR("BLE transport init failed: %d", err);
        return err;
    }

    /* Register BLE transport */
    err = transport_register(transport_ble_get());
    if (err) {
        LOG_ERR("BLE transport register failed: %d", err);
        return err;
    }

    /* Initialize UDP transport */
    err = transport_udp_init();
    if (err) {
        LOG_WRN("UDP transport init failed: %d", err);
        /* Continue anyway - UDP is optional */
    }

    /* Register UDP transport */
    err = transport_register(transport_udp_get());
    if (err) {
        LOG_WRN("UDP transport register failed: %d", err);
        /* Continue anyway - UDP is optional */
    }

    /* Initialize audio subsystem */
    err = audio_init();
    if (err) {
        LOG_ERR("Audio init failed: %d", err);
        return err;
    }

    /* Initialize storage subsystem */
    err = storage_init();
    if (err) {
        LOG_WRN("Storage init failed: %d", err);
        /* No SD: the FS log backend below is never activated, so make the
         * idle-power-off gate see "off" even in a debug build. */
        clip_log_fs_set_active(false);
        /* Continue anyway - storage is optional */
    } else {
        /* SD card mounted — restore the untransferred indicator from the
         * persisted flag (no card walk; boot stays fast). Empty/phantom
         * sessions are cleaned at encounter time by the transfer path. */
        display_check_untransferred();

#ifdef CONFIG_LOG_BACKEND_FS
        const struct log_backend *fs_be = log_backend_get_by_name("log_backend_fs");
        if (fs_be) {
            if (IS_ENABLED(CONFIG_CLIP_LOG_FS_DEFAULT_ON)) {
                /* Debug: FS log on by default (WRN+ERR to /SD:/LOG) */
                log_backend_activate(fs_be, NULL);
                uint32_t src_cnt = log_src_cnt_get(0);
                for (uint32_t i = 0; i < src_cnt; i++) {
                    log_filter_set(fs_be, 0, (int16_t)i, LOG_LEVEL_INF);
                }
                clip_log_fs_set_active(true);
            } else {
                /* Production: FS log off (enable via AT+LOG) */
                log_backend_deactivate(fs_be);
                clip_log_fs_set_active(false);
            }
        }
#endif
    }

    /* Initialize USB CDC ACM + MSC (serial port + SD card drive) */
    err = usb_cdc_init();
    if (err) {
        LOG_WRN("USB init failed: %d", err);
    }

    /* Initialize transfer subsystem */
    err = transfer_init();
    if (err) {
        LOG_WRN("Transfer init failed: %d", err);
        /* Continue anyway - transfer is optional */
    }

    /* Initialize RTC streaming (registers the audio data callback) */
    err = rtc_stream_init();
    if (err) {
        LOG_WRN("RTC stream init failed: %d", err);
        /* Continue anyway - RTC is optional */
    }

    /* Initialize WiFi subsystem */
    err = wifi_init();
    if (err) {
        LOG_WRN("WiFi init failed: %d", err);
        /* Continue anyway - WiFi is optional */
    }

    /* Initialize WiFi UDP server */
    err = wifi_udp_init();
    if (err) {
        LOG_WRN("WiFi UDP init failed: %d", err);
        /* Continue anyway - UDP is optional */
    }

    /* Register AT commands BEFORE starting server thread */
    err = at_commands_register();
    if (err) {
        LOG_ERR("AT commands register failed: %d", err);
        return err;
    }

    /* Initialize AT server (commands must be registered first) */
    err = at_server_init();
    if (err) {
        LOG_ERR("AT server init failed: %d", err);
        return err;
    }

    /* Initialize button handler */
    err = button_init();
    if (err) {
        LOG_WRN("Button init failed: %d", err);
        /* Continue anyway - button is optional */
    }

    /* Initialize event dispatcher (depends on audio, haptic, display, wifi) */
    err = clip_event_init();
    if (err) {
        LOG_ERR("Event dispatcher init failed: %d", err);
        return err;
    }

    /* Clear status (battery_percent/charging set by battery_init) */
    g_ctx.status.recording_time = 0;
    g_ctx.status.free_space = 0;
    g_ctx.status.session_count = 0;

    /* Transition to idle state */
    clip_event_get_state();  /* Already set by clip_event_init */

    LOG_INF("ready: normal=%u/%u enhanced=%u/%u",
           CONFIG_CLIP_NORMAL_BITRATE, CONFIG_CLIP_NORMAL_COMPLEXITY,
           CONFIG_CLIP_ENHANCED_BITRATE, CONFIG_CLIP_ENHANCED_COMPLEXITY);

    return 0;
}

extern struct k_heap _system_heap;

static void thread_stack_stats_cb(const struct k_thread *thread, void *user_data)
{
	ARG_UNUSED(user_data);

	size_t stack_size, free_bytes;

#ifdef CONFIG_THREAD_STACK_INFO
	stack_size = thread->stack_info.size;
	if (k_thread_stack_space_get(thread, &free_bytes) == 0) {
		size_t used = stack_size - free_bytes;
		const char *name = k_thread_name_get(
			(struct k_thread *)thread);
		if (!name || name[0] == '\0') {
			name = "?";
		}
		LOG_INF("  %-20s %5u/%5u (%2u%%)",
			name, used, stack_size,
			stack_size > 0 ? (uint32_t)(used * 100 / stack_size) : 0);
	}
#endif
}

void clip_main_loop(void)
{

    int stats_counter = 0;

    while (true) {
        /* Use K_FOREVER when not recording to allow deep idle;
         * use 1s timeout during recording for time tracking */
        k_timeout_t wait = (clip_event_get_state() == CLIP_STATE_RECORDING)
                           ? K_MSEC(1000) : K_FOREVER;
        clip_event_wait(wait);

        /* Process all pending events */
        clip_event_process();

        /* Update recording time if recording */
        if (clip_event_get_state() == CLIP_STATE_RECORDING) {
            g_ctx.status.recording_time++;
        }

        /* Print thread stack stats every 10 seconds */
        if (IS_ENABLED(CONFIG_CLIP_DEBUG_STATS) && ++stats_counter >= 10) {
            stats_counter = 0;

            LOG_INF("--- Thread Stack Usage ---");
            k_thread_foreach(thread_stack_stats_cb, NULL);

            /* Heap usage */
            struct sys_memory_stats hs;
            if (sys_heap_runtime_stats_get(&_system_heap.heap, &hs) == 0) {
                LOG_INF("  HEAP: %u/%u used (peak %u)",
                        hs.allocated_bytes,
                        hs.allocated_bytes + hs.free_bytes,
                        hs.max_allocated_bytes);
            }
        }
    }
}

/*
 * Crystal load-capacitor tuning.
 *
 * The board has no external load capacitors for the HFXO (32 MHz) or LFXO
 * (32.768 kHz); the internal ones must be enabled through the OSCILLATORS
 * peripheral. The values below were tuned with the tests/clip `hfxo`/`lfxo`
 * shell and are written here the same way — as raw register fields, not via
 * the DTS femtofarad/picofarad properties (the HFXO DTS binding cannot take a
 * raw CAPVALUE; it derives one from per-chip FICR, which is not what we want).
 *
 * SoC init writes these registers once at boot (PRE_KERNEL) from the DTS;
 * this runs afterwards (POST_KERNEL) and overrides with the tuned values.
 * Neither register is touched again at runtime, so the override sticks.
 */
static int clip_xo_cap_init(void)
{
	NRF_OSCILLATORS->XOSC32MCAPS =
		(OSCILLATORS_XOSC32MCAPS_ENABLE_Enabled <<
		 OSCILLATORS_XOSC32MCAPS_ENABLE_Pos) |
		(CONFIG_CLIP_HFXO_CAPVALUE << OSCILLATORS_XOSC32MCAPS_CAPVALUE_Pos);
	NRF_OSCILLATORS->XOSC32KI.INTCAP = CONFIG_CLIP_LFXO_INTCAP;
	return 0;
}
SYS_INIT(clip_xo_cap_init, POST_KERNEL, 0);

int main(void)
{
    /* Print version and build info at startup */
    LOG_WRN("Clip Firmware v%s", CLIP_VERSION); /* WRN so it survives the module diet — boot evidence */
    LOG_WRN("Build: %s %s", __DATE__, __TIME__);

    int err;

    /* Initialize application */
    err = clip_init();
    if (err) {
        LOG_ERR("Application init failed: %d", err);
        return err;
    }

    /* Enter main loop */
    clip_main_loop();

    return 0;
}
```

## include/at_cmd.h
```c
/*
 * Copyright (c) 2024 Seeed Technology Co., Ltd.
 *
 * SPDX-License-Identifier: Apache-2.0
 */

#ifndef AT_CMD_H
#define AT_CMD_H

/**
 * @brief AT command types (bitmask values for allowed_types checking)
 */
enum at_cmd_type {
    AT_CMD_EXEC = 0x01,    /* Execute without parameters: AT+XX */
    AT_CMD_SET  = 0x02,    /* Set parameter: AT+XX=<value> */
    AT_CMD_GET  = 0x04,    /* Query parameter: AT+XX? */
};

/**
 * @brief Parsed AT command
 */
struct at_command {
    enum at_cmd_type type;
    char name[32];      /* Command name (e.g., "GSTAT", "BITRATE") */
    char *value;        /* Parameter value (for SET commands) */
};

/**
 * @brief Initialize AT command parser
 *
 * @return 0 on success, negative error code on failure
 */
int at_cmd_init(void);

/**
 * @brief Parse AT command string
 *
 * @param cmd_str Command string to parse
 * @param cmd Output parsed command structure
 * @return 0 on success, negative error code on failure
 */
int at_cmd_parse(const char *cmd_str, struct at_command *cmd);

/**
 * @brief Execute AT command
 *
 * @param cmd Parsed command to execute
 * @param response Output JSON response string (must be freed by caller)
 * @return 0 on success, negative error code on failure
 */
int at_cmd_execute(const struct at_command *cmd, char **response);

/**
 * @brief Cleanup parsed command
 *
 * @param cmd Command to cleanup
 */
void at_cmd_cleanup(struct at_command *cmd);

#endif /* AT_CMD_H */
```

## include/battery.h
```c
/*
 * Copyright (c) 2025 Seeed Technology Co., Ltd.
 *
 * SPDX-License-Identifier: Apache-2.0
 */

#ifndef CLIP_BATTERY_H
#define CLIP_BATTERY_H

/**
 * @brief Initialize battery monitoring
 *
 * Sets up NPM1300 interrupt callbacks for charging events (VBUS, charge complete)
 * and starts periodic battery level polling (60s interval).
 * Updates BLE Battery Service with level and charging status.
 *
 * @return 0 on success, negative error code on failure
 */
int battery_init(void);

/**
 * @brief Milliseconds since the fuel-gauge state was last persisted
 *        (INT64_MAX when never). Lets shutdown skip a redundant save.
 */
int64_t battery_fg_state_age_ms(void);

/**
 * @brief Poll battery status immediately
 *
 * Reads sensors, updates fuel gauge SoC, and refreshes display/BLE.
 * Call this when the user triggers a status bar display to get fresh readings.
 */
void battery_poll(void);

/**
 * @brief Persist the nRF Fuel Gauge state to settings (LittleFS)
 *
 * Saves the fuel gauge internal state so the SoC is continuous across reboots
 * (without this, every reboot re-estimates SoC from the resting voltage and
 * the displayed % jumps). Called on SoC change (infrequent) + on graceful
 * shutdown/reboot (a fresh copy before power-off).
 */
void battery_save_fg_state(void);

/* VBUS present (USB plugged), regardless of active charging — a full pack on
 * USB still has VBUS up and the PMIC refuses ship mode. Power-off paths gate
 * on this, NOT on status.battery_charging (false once the charge completes). */
bool battery_vbus_present(void);

/* Recording allowed? Latched off at critical battery (raw SoC <=3% or
 * <=3.45V; a graceful STOP runs there), unlocked by charging/VBUS or
 * recovery to >=8%. VBUS alone unlocks (external power). START paths
 * (AT + button) gate on this. */
bool battery_recording_allowed(void);

/* WiFi AP allowed? Blocked while discharging below
 * CONFIG_CLIP_WIFI_MIN_BATTERY_PERCENT (default 15%) or
 * CONFIG_CLIP_WIFI_MIN_BATTERY_MV (default 3500 mV). Charging or VBUS
 * bypasses both floors (external power), and the critical recording
 * lockout also blocks. Used by AT+WIFI=on and the WIFI_ON transition. */
bool battery_wifi_allowed(void);

#endif /* CLIP_BATTERY_H */
```

## include/bookmarks.h
```c
/*
 * Copyright (c) 2025 Seeed Technology Co., Ltd.
 *
 * SPDX-License-Identifier: Apache-2.0
 */

#ifndef BOOKMARKS_H
#define BOOKMARKS_H

#include <stdint.h>
#include <stdbool.h>
#include <zephyr/kernel.h>

/* Bookmark entry - simplified to only store offset in seconds */
struct bookmark {
	uint32_t offset_sec;    /* Seconds from session start (key timestamp) */
};

/**
 * @brief Add a bookmark (directly writes to file, no cache)
 *
 * @param session_id Session ID
 * @param offset_sec Seconds from session start
 * @return 0 on success, negative error code on failure
 */
int bookmarks_add(const char *session_id, uint32_t offset_sec);

/**
 * @brief Get bookmarks for a session (with pagination)
 *
 * @param session_id Session ID
 * @param page Page number (1-based)
 * @param per_page Items per page
 * @param bookmarks Output array for bookmarks
 * @param max_count Maximum number of bookmarks to return
 * @return Number of bookmarks found, or negative error code
 */
int bookmarks_get_page(const char *session_id, int page, int per_page,
                      struct bookmark *bookmarks, int max_count);

/**
 * @brief Get bookmark count for a session
 *
 * @param session_id Session ID
 * @return Number of bookmarks, or negative error code
 */
int bookmarks_count(const char *session_id);

/**
 * @brief Clear all bookmarks for a session
 *
 * @param session_id Session ID
 * @return 0 on success, negative error code on failure
 */
int bookmarks_clear(const char *session_id);

#endif /* BOOKMARKS_H */
```
