## boards/seeed/clip/board.yml
```yaml
board:
  name: clip
  vendor: seeed
  socs:
  - name: nrf5340
    variants:
    - name: ns
      cpucluster: cpuapp
```

## drivers/Kconfig
```kconfig
# SPDX-License-Identifier: Apache-2.0

# ReSpeaker Lav custom drivers configuration

rsource "input/Kconfig"
rsource "display/Kconfig"
```

## drivers/display/Kconfig
```kconfig
# SPDX-License-Identifier: Apache-2.0

# CH1115 OLED display driver configuration

config OLED_DISPLAY
	bool "CH1115 OLED display driver"
	default y
	depends on DT_HAS_SOLOMON_CH1115_ENABLED
	select I2C
	select DISPLAY
	help
	  Enable CH1115-based OLED display driver (88x48 I2C).
```

## drivers/input/Kconfig
```kconfig
# SPDX-License-Identifier: Apache-2.0

# GPIO button input driver configuration

config GPIO_BUTTON
	bool "GPIO button input driver"
	select INPUT
	help
	  Enable GPIO button input driver using custom button API.

if GPIO_BUTTON

config INPUT_GPIO_BUTTON_OWN_THREAD
	bool "Own thread"
	help
	  Each button device has its own thread.

config INPUT_GPIO_BUTTON_GLOBAL_THREAD
	bool "Global work queue"
	depends on !INPUT_GPIO_BUTTON_OWN_THREAD
	help
	  All button devices share the same work queue.

config INPUT_GPIO_BUTTON_THREAD_STACK_SIZE
	int "Stack size"
	depends on INPUT_GPIO_BUTTON_OWN_THREAD
	default 256
	help
	  Stack size for the button thread.

config INPUT_GPIO_BUTTON_THREAD_PRIORITY
	int "Thread priority"
	depends on INPUT_GPIO_BUTTON_OWN_THREAD
	default 0
	help
	  Priority of the button thread.

endif
```

## dts/bindings/display/solomon,ch1115.yaml
```yaml
# SPDX-License-Identifier: Apache-2.0

description: CH1115 OLED display controller

compatible: "solomon,ch1115"

include: i2c-device.yaml

properties:
  reset-gpios:
    type: phandle-array
    required: false
    description: Reset GPIO

  width:
    type: int
    required: true
    description: Display width in pixels

  height:
    type: int
    required: true
    description: Display height in pixels

  segment-offset:
    type: int
    required: false
    default: 0
    description: Segment offset

  page-offset:
    type: int
    required: false
    default: 0
    description: Page offset

  display-offset:
    type: int
    required: false
    default: 0
    description: Display offset

  multiplex-ratio:
    type: int
    required: false
    default: 63
    description: Multiplex ratio

  prechargep:
    type: int
    required: false
    default: 0x22
    description: Precharge period

  segment-remap:
    type: int
    required: false
    default: 0
    description: Segment remap

  com-invdir:
    type: int
    required: false
    default: 0
    description: COM output scan direction
```

## dts/bindings/gpio-button.yaml
```yaml
# SPDX-License-Identifier: Apache-2.0

description: |
  Software debounced button with single, double, long press detection.

compatible: "gpio-button"

include: base.yaml

properties:
  gpios:
    type: phandle-array
    required: true
    description: GPIO pin the button is connected to

  label:
    type: string
    description: Human-readable label for the button

  debounce-ms:
    type: int
    required: false
    default: 30
    description: Debounce time in milliseconds

  long-press-ms:
    type: array
    required: false
    description: Multi-level long-press thresholds in milliseconds

  double-click-ms:
    type: int
    required: false
    default: 400
    description: Max time between two clicks for double click in ms
```

## lib/Kconfig
```kconfig
# SPDX-License-Identifier: Apache-2.0

# ReSpeaker Lav custom libraries configuration

rsource "opus/Kconfig"
rsource "speexdsp/Kconfig"
rsource "lua/Kconfig"
```

## lib/lua/Kconfig
```kconfig
# SPDX-License-Identifier: Apache-2.0

config LUA
	bool "Lua 5.5.0 Scripting Language"
	help
	  Enable Lua 5.5.0 scripting language library for embedded applications.
```

## lib/opus/Kconfig
```kconfig
# SPDX-License-Identifier: Apache-2.0

config OPUS_CODEC
	bool "Opus Audio Codec"
	help
	  Enable Opus 1.6.1 audio codec library for encoding/decoding.
```

## lib/speexdsp/Kconfig
```kconfig
# SPDX-License-Identifier: Apache-2.0

config SPEEXDSP
	bool "SpeexDSP Audio Processing Library"
	help
	  Enable SpeexDSP library for audio signal processing.
	  Provides noise suppression, dereverberation, and other DSP features.
```
