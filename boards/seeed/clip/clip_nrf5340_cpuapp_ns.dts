/dts-v1/;
#include <nordic/nrf5340_cpuappns_qkaa.dtsi>
#include "clip-pinctrl.dtsi"

/ {
	model = "Clip (CPUAPP Non-Secure)";
	compatible = "seeed,clip-cpuapp-ns";

	chosen {
		zephyr,sram = &sram0_ns;
		zephyr,flash = &flash0;
		zephyr,code-partition = &slot0_ns_partition;
		zephyr,bt-hci = &bt_hci_ipc0;
		nordic,802154-spinel-ipc = &ipc0;
	};
};

#include "clip-cpuapp_partitioning.dtsi"
#include "clip-shared_sram.dtsi"
