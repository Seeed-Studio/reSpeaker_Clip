## CMakeLists.txt
```
#
# Copyright (c) 2026 Seeed Technology Co., Ltd.
#
# SPDX-License-Identifier: LicenseRef-Nordic-5-Clause
#

cmake_minimum_required(VERSION 3.20.0)

find_package(Zephyr REQUIRED HINTS $ENV{ZEPHYR_BASE})
project(re_test)

target_sources(app PRIVATE
	src/main.c
	src/re_test.c
	src/ble.c
	src/wifi.c
	src/button.c
	src/sdcard.c
	src/mic.c
	src/oled.c
	src/pmic.c
	src/motor.c
	src/imu.c
	src/flash_test.c
	src/discharge.c
)
```

## sysbuild.conf
```
# RE firmware — MCUboot build (default).
#
# Inherits the board sysbuild defaults (boards/seeed/clip/Kconfig.sysbuild):
# MCUboot + signed dual-image OTA + NETCORE ipc_radio + secure netcore.
# Flash once via J-Link with the merged hex, then upgrade over USB serial
# DFU (MCUboot serial recovery) or BLE OTA like the application firmware.
#
# Direct-J-Link variant (links at 0x0, no bootloader — factory/test flash):
# uncomment the three lines below. With Partition Manager disabled the image
# links at 0x0; with it enabled the app lands in the mcuboot slot.
#
# SB_CONFIG_BOOTLOADER_NONE=y
# SB_CONFIG_SECURE_BOOT_NETCORE=n
# SB_CONFIG_PARTITION_MANAGER=n
```

## prj.conf
```kconfig
#
# Copyright (c) 2023 Nordic Semiconductor ASA
#
# SPDX-License-Identifier: LicenseRef-Nordic-5-Clause
#

# DMIC (Digital Microphone)
CONFIG_AUDIO=y
CONFIG_AUDIO_DMIC=y

# GPIO button input driver
CONFIG_INPUT=y
CONFIG_INPUT_GPIO_BUTTON_OWN_THREAD=y
CONFIG_INPUT_GPIO_BUTTON_THREAD_STACK_SIZE=1024
CONFIG_GPIO_BUTTON=y

# SD Card and File System
CONFIG_DISK_ACCESS=y
CONFIG_DISK_DRIVER_SDMMC=y
CONFIG_FILE_SYSTEM=y
CONFIG_FAT_FILESYSTEM_ELM=y
CONFIG_FS_FATFS_LFN=y
CONFIG_FS_FATFS_MKFS=y
CONFIG_FILE_SYSTEM_MKFS=y

# SPI Flash
CONFIG_FLASH=y
CONFIG_FLASH_MAP=y

# WiFi AP mode
CONFIG_WIFI=y
CONFIG_WIFI_NRF70=y
CONFIG_NRF70_AP_MODE=y
CONFIG_WIFI_NM_WPA_SUPPLICANT=y
CONFIG_WIFI_NM_WPA_SUPPLICANT_AP=y
CONFIG_WIFI_NM_WPA_SUPPLICANT_LOG_LEVEL_INF=n
CONFIG_WIFI_RANDOM_MAC_ADDRESS=y

# WiFi and BLE coexistence
CONFIG_NRF70_SR_COEX=y
CONFIG_WIFI_READY_LIB=y
CONFIG_NRF_WIFI_IF_AUTO_START=n

# Reduce memory usage - fewer buffers
CONFIG_NRF70_RX_NUM_BUFS=8
CONFIG_NRF70_MAX_TX_AGGREGATION=2

# Disable RPU power save
CONFIG_NRF70_RPU_PS_IDLE_TIMEOUT_MS=3600000

# WiFi credentials - not needed for AP mode
CONFIG_WIFI_CREDENTIALS=n

# Disable WPA3/SAE - WPA2-PSK only (v3.3.0: WPA3 is now a choice)
CONFIG_WIFI_NM_WPA_SUPPLICANT_WPA3_IMPLEMENTATION_NONE=y

# WiFi memory
CONFIG_NRF_WIFI_CTRL_HEAP_SIZE=20000
CONFIG_NRF_WIFI_DATA_HEAP_SIZE=53000
CONFIG_WIFI_NM_WPA_SUPPLICANT_THREAD_STACK_SIZE=10240

# zperf for throughput testing
CONFIG_NET_ZPERF=y

# Networking Management API
CONFIG_NET_MGMT=y
CONFIG_NET_MGMT_EVENT=y

# AP static IP
CONFIG_NET_CONFIG_SETTINGS=y
CONFIG_NET_CONFIG_INIT_TIMEOUT=0
CONFIG_NET_CONFIG_MY_IPV4_ADDR="192.168.4.1"
CONFIG_NET_CONFIG_MY_IPV4_NETMASK="255.255.255.0"
CONFIG_NET_CONFIG_MY_IPV4_GW="192.168.4.1"

# DHCP server for AP clients
CONFIG_NET_DHCPV4=y
CONFIG_NET_DHCPV4_SERVER=y
CONFIG_NET_DHCPV4_SERVER_ADDR_COUNT=1

# Shell - minimal
CONFIG_SHELL=y
CONFIG_SHELL_BACKEND_SERIAL=y
CONFIG_NET_SHELL=n
CONFIG_WIFI_CREDENTIALS_SHELL=n
CONFIG_NET_L2_WIFI_SHELL=n

# Filesystem shell commands
CONFIG_FILE_SYSTEM_SHELL=y

# Flash and Regulator shell commands
CONFIG_FLASH_SHELL=y
CONFIG_REGULATOR=y
CONFIG_REGULATOR_SHELL=y
CONFIG_GPIO_SHELL=y

# Sensor (for PMIC battery/charger monitoring)
CONFIG_SENSOR=y


# I2C and I2C shell commands
CONFIG_I2C=y
CONFIG_I2C_SHELL=y

# Shell stack size - increased for WiFi operations
CONFIG_SHELL_STACK_SIZE=4096

# Logging - minimal, use thread mode to reduce impact
CONFIG_LOG=y
CONFIG_LOG_DEFAULT_LEVEL=3
CONFIG_LOG_BACKEND_UART=y
CONFIG_LOG_BACKEND_RTT=n
# CONFIG_LOG_MODE_IMMEDIATE is not set - use threaded mode

# System settings
CONFIG_NEWLIB_LIBC=y
CONFIG_NEWLIB_LIBC_NANO=n

# Minimal networking - UDP only
CONFIG_NETWORKING=y
CONFIG_NET_SOCKETS=y
CONFIG_NET_SOCKETS_POLL_MAX=4
CONFIG_NET_L2_ETHERNET=y
CONFIG_NET_L2_WIFI_MGMT=y
CONFIG_NET_IPV4=y
CONFIG_NET_IPV6=n
CONFIG_NET_UDP=y
CONFIG_NET_TCP=n

# mbedTLS - use nRF security library instead of builtin
CONFIG_MBEDTLS=y
CONFIG_MBEDTLS_LEGACY_CRYPTO_C=n

# Memory optimization - reduced for RAM efficiency
CONFIG_SYSTEM_WORKQUEUE_STACK_SIZE=6144
CONFIG_MAIN_STACK_SIZE=6144

# Heap size for WiFi/crypto operations
CONFIG_HEAP_MEM_POOL_SIZE=120000

CONFIG_MBEDTLS_HEAP_SIZE=1024

# Network buffers (balanced for stability)
CONFIG_NET_TC_TX_COUNT=2
CONFIG_NET_BUF_TX_COUNT=14
CONFIG_NET_BUF_RX_COUNT=14
CONFIG_NET_PKT_TX_COUNT=6
CONFIG_NET_PKT_RX_COUNT=6
CONFIG_NET_TX_STACK_SIZE=4096
CONFIG_NET_RX_STACK_SIZE=4096

CONFIG_NET_BUF_FIXED_DATA_SIZE=y
CONFIG_NET_BUF_DATA_SIZE=512

# DHCP
CONFIG_NET_DHCPV4=y

CONFIG_WIFI_RANDOM_MAC_ADDRESS=y
CONFIG_BT=y
CONFIG_BT_PERIPHERAL=y
CONFIG_BT_DEVICE_NAME="Clip_Test"
CONFIG_BT_MAX_CONN=1
CONFIG_BT_SMP=y
CONFIG_BT_SIGNING=y
CONFIG_BT_GATT_CLIENT=y

# BLE throughput optimization
CONFIG_BT_BUF_ACL_RX_SIZE=251
CONFIG_BT_BUF_ACL_TX_SIZE=251
CONFIG_BT_L2CAP_TX_MTU=247
CONFIG_BT_CTLR_DATA_LENGTH_MAX=251

# Increase thread priority for BLE operations
CONFIG_BT_RX_STACK_SIZE=2048

# Display support (OLED CH1115)
CONFIG_DISPLAY=y
CONFIG_GPIO=y

# USB Mass Storage (expose SD card as USB drive)
CONFIG_USB_DEVICE_STACK_NEXT=y
CONFIG_USBD_MSC_CLASS=y
CONFIG_USBD_MSC_LUNS_PER_INSTANCE=1
CONFIG_USBD_MSC_DOUBLE_BUFFERING=n
CONFIG_USBD_MSC_SCSI_BUFFER_SIZE=512

# RE's USB is MSC-only (cdc_acm_uart is disabled in the overlay). Under
# MCUboot the board default pulls in CLIP_USB_DFU_DEFAULT_CDC, whose
# USBD_CDC_ACM_CLASS select violates the disabled CDC DT node — turn it
# off like the clip app does. Serial-recovery entry on RE: hold the
# button while powering on (VBUS-gated), then upload over USB serial.
CONFIG_CLIP_USB_DFU_DEFAULT_CDC=n
CONFIG_HWINFO=y

# Reboot command
CONFIG_REBOOT=y
```

## boards/clip_nrf5340_cpuapp.overlay
```dts
/*
 * Copyright (c) 2023 Nordic Semiconductor ASA
 *
 * SPDX-License-Identifier: LicenseRef-Nordic-5-Clause
 */

/* UART configuration for 921600 baud rate */
&uart0 {
	current-speed = <921600>;
};

/* Enable USB device for MSC only */
&usbd {
	status = "okay";
	cdc_acm_uart {
		status = "disabled";
	};
};

/* Certification build: cap charge current at 100 mA (board default 220 mA).
 * Trickle stays a fixed 10% of ICHG = 10 mA. */
&npm1300_charger {
	current-microamp = <100000>;
};
```

## src/main.c
```c
/*
 * Copyright (c) 2026 Seeed Technology Co., Ltd.
 *
 * SPDX-License-Identifier: LicenseRef-Nordic-5-Clause
 */

#include <zephyr/kernel.h>
#include <zephyr/logging/log.h>

#include "button.h"
#include "sdcard.h"
#include "oled.h"
#include "pmic.h"
#include "motor.h"
#include "mic.h"
#include "wifi.h"
#include "ble.h"
#include "re_test.h"
#include "discharge.h"

LOG_MODULE_REGISTER(main, LOG_LEVEL_INF);

int main(void)
{
	int ret;

	printk("=== RE Test Firmware ===\n");
	printk("Auto peripheral reliability test\n\n");

	/* Initialize peripherals */
	ret = button_init();
	if (ret != 0) {
		LOG_WRN("Button init failed: %d", ret);
	}

	ret = sdcard_init();
	if (ret != 0) {
		LOG_WRN("SD card init failed: %d", ret);
	}

	ret = mic_init();
	if (ret != 0) {
		LOG_WRN("MIC init failed: %d", ret);
	}

	ret = oled_init();
	if (ret != 0) {
		LOG_WRN("OLED init failed: %d", ret);
	}

	ret = pmic_init();
	if (ret != 0) {
		LOG_WRN("PMIC init failed: %d", ret);
	}

	ret = motor_init();
	if (ret != 0) {
		LOG_WRN("Motor init failed: %d", ret);
	}

	/* Start WiFi AP */
	ret = wifi_run_test();
	if (ret != 0) {
		LOG_WRN("WiFi init failed: %d", ret);
	}

	/* Start the continuous UDP TX discharge load (auto-starts, waits for AP) */
	wifi_discharge_start();

	/* Start BLE advertising */
	ret = ble_init();
	if (ret != 0) {
		LOG_WRN("BLE init failed: %d", ret);
	}

	printk("All peripherals initialized\n");
	printk("Starting battery discharge/charge cycle test...\n\n");

	/* Run the battery discharge/charge cycle test (never returns) */
	discharge_run();

	return 0;
}
```

## src/button.c
```c
/*
 * Copyright (c) 2026 Seeed Technology Co., Ltd.
 *
 * SPDX-License-Identifier: LicenseRef-Nordic-5-Clause
 */

#include <zephyr/kernel.h>
#include <zephyr/device.h>
#include <zephyr/drivers/input/button.h>
#include <zephyr/logging/log.h>
#include "button.h"
#include "oled.h"
#include "pmic.h"

LOG_MODULE_REGISTER(button, LOG_LEVEL_INF);

/* Show the power-off page before cutting power, so the gesture has
 * visible feedback (and so a failed ship mode — e.g. USB/charger
 * attached, which the nPM1300 rejects — leaves the page on screen
 * instead of looking like the button did nothing). */
static void button_power_off(void)
{
	LOG_INF("Power off — ship mode");
	oled_show_power_off();
	k_sleep(K_MSEC(800));
	pmic_enter_ship_mode();
	LOG_ERR("Ship mode failed (USB/charger attached?)");
}

static void button_event_cb(const struct device *dev, enum button_action action)
{
	switch (action) {
	case BUTTON_DOUBLE_CLICK:
		button_power_off();
		break;
	case BUTTON_LONG_PRESS_LEVEL_1:
		/* 3 s hold — same gesture as the production app's power-off */
		button_power_off();
		break;
	case BUTTON_SINGLE_CLICK:
		LOG_INF("Button click");
		break;
	default:
		break;
	}
}

int button_init(void)
{
	const struct device *btn = DEVICE_DT_GET(DT_ALIAS(sw0));
	int ret;

	if (!device_is_ready(btn)) {
		LOG_ERR("Button device not ready");
		return -ENODEV;
	}

	ret = button_callback_register(btn, button_event_cb);
	if (ret < 0) {
		LOG_ERR("Button callback register failed: %d", ret);
		return ret;
	}

	LOG_INF("Button ready (double click or 3s hold = ship mode)");

	return 0;
}
```

## src/discharge.c
```c
/*
 * Copyright (c) 2026 Seeed Technology Co., Ltd.
 *
 * SPDX-License-Identifier: LicenseRef-Nordic-5-Clause
 *
 * Battery discharge/charge cycle test state machine. Polls the NPM1300
 * charger every few seconds, drives the charger enable to alternate between
 * discharging (WiFi TX load drains the cell) and charging, and keeps the
 * OLED updated with % / state / voltage. The cycle is driven purely by cell
 * voltage (the nRF Fuel Gauge SoC was unreliable under the pulsed WiFi TX
 * load).
 */

#include <zephyr/kernel.h>
#include <zephyr/logging/log.h>
#include <stdio.h>
#include "discharge.h"
#include "pmic.h"
#include "oled.h"
#include "wifi.h"

LOG_MODULE_REGISTER(discharge, LOG_LEVEL_INF);

/* Voltage-hysteresis thresholds (cell voltage, not fuel-gauge SoC):
 *  - DISCHARGE -> CHARGE when the cell sinks to 3.3 V,
 *  - CHARGE    -> DISCHARGE when the cell rises to 4.12 V.
 * The 0.82 V gap prevents oscillation around the switching point. */
#define DISCHARGE_VOLTAGE_MV		3350U	/* start charging at/below */
#define CHARGE_VOLTAGE_MV		4120U	/* start discharging at/above */
#define POLL_INTERVAL_MS		5000U

enum cycle_state {
	STATE_DISCHARGE,
	STATE_CHARGE,
};

void discharge_run(void)
{
	enum cycle_state state = STATE_DISCHARGE;
	uint32_t cycles = 0U;
	uint8_t pct = 0U;
	uint32_t mv = 0U;
	bool charging = false;

	printk("\n=== Battery discharge/charge cycle test ===\n");
	printk("Discharging to %u mV, then charging to %u mV, repeat.\n\n",
	       DISCHARGE_VOLTAGE_MV, CHARGE_VOLTAGE_MV);

	/* Start in DISCHARGE: charger off, WiFi AP + TX load on. */
	pmic_charger_set(false);
	wifi_discharge_load_enable(true);

	for (;;) {
		int ret = pmic_get_battery_status(&mv, &pct, &charging);
		const char *label = (state == STATE_DISCHARGE) ?
				    "DISCHARGE" : "CHARGE";

		if (ret == 0) {
			oled_show_battery(pct, charging, mv, label, cycles);

			if (state == STATE_DISCHARGE) {
				if (mv <= DISCHARGE_VOLTAGE_MV) {
					LOG_INF("cycle %u: %u mV reached -> CHARGE",
						cycles, mv);
					state = STATE_CHARGE;
					/* Charge with minimal load: WiFi off
					 * (AP down + TX idle) for low power. */
					wifi_discharge_load_enable(false);
					pmic_charger_set(true);
				}
			} else { /* STATE_CHARGE */
				if (mv >= CHARGE_VOLTAGE_MV) {
					cycles++;
					LOG_INF("cycle %u: %u mV reached -> DISCHARGE",
						cycles, mv);
					state = STATE_DISCHARGE;
					pmic_charger_set(false);
					wifi_discharge_load_enable(true);
				}
			}
		} else {
			LOG_WRN("battery read failed: %d", ret);
		}

		k_sleep(K_MSEC(POLL_INTERVAL_MS));
	}
}
```

## src/discharge.h
```c
/*
 * Copyright (c) 2026 Seeed Technology Co., Ltd.
 *
 * SPDX-License-Identifier: LicenseRef-Nordic-5-Clause
 *
 * Battery discharge/charge cycle test. Discharges the cell via the WiFi TX
 * load down to 3.35 V, then charges to 4.12 V, then repeats. The OLED always
 * shows the current %, voltage, and charge/discharge state.
 */

#ifndef DISCHARGE_H
#define DISCHARGE_H

/**
 * @brief Run the battery discharge/charge cycle test (blocking, never returns).
 *
 * Requires WiFi AP + discharge TX load already started.
 */
void discharge_run(void);

#endif /* DISCHARGE_H */
```

## src/oled.c
```c
/*
 * Copyright (c) 2023 Nordic Semiconductor ASA
 *
 * SPDX-License-Identifier: LicenseRef-Nordic-5-Clause
 */

#include <zephyr/kernel.h>
#include <zephyr/device.h>
#include <zephyr/drivers/display.h>
#include <zephyr/shell/shell.h>
#include <zephyr/logging/log.h>
#include <stdlib.h>
#include "oled.h"

LOG_MODULE_REGISTER(oled, LOG_LEVEL_INF);

/* Display dimensions */
#define OLED_WIDTH  88
#define OLED_HEIGHT 48
#define OLED_BUF_SIZE (OLED_WIDTH * OLED_HEIGHT / 8)

/* Display device */
static const struct device *display_dev = NULL;

/* Display buffer */
static uint8_t display_buffer[OLED_BUF_SIZE];

/* Write buffer to display */
static void oled_write_buffer(void)
{
	if (!display_dev) {
		return;
	}

	struct display_buffer_descriptor desc = {
		.buf_size = OLED_BUF_SIZE,
		.width = OLED_WIDTH,
		.height = OLED_HEIGHT,
		.pitch = OLED_WIDTH,
	};

	display_write(display_dev, 0, 0, &desc, display_buffer);
}

/* Clear display (set all pixels to 0) */
static void oled_clear_buffer(void)
{
	memset(display_buffer, 0, OLED_BUF_SIZE);
}

/* Fill display (set all pixels to 1) */
static void oled_fill_buffer(void)
{
	memset(display_buffer, 0xFF, OLED_BUF_SIZE);
}

/* Draw a simple test pattern */
static void oled_draw_test_pattern(void)
{
	oled_clear_buffer();

	/* Draw border */
	for (int x = 0; x < OLED_WIDTH; x++) {
		/* Top and bottom rows */
		display_buffer[x] = 0x80;
		display_buffer[OLED_BUF_SIZE - OLED_WIDTH + x] = 0x01;
	}
	for (int y = 1; y < OLED_HEIGHT / 8 - 1; y++) {
		/* Left and right columns */
		display_buffer[y * OLED_WIDTH] = 0xFF;
		display_buffer[(y + 1) * OLED_WIDTH - 1] = 0xFF;
	}

	/* Draw diagonal line */
	for (int i = 0; i < OLED_WIDTH && i < OLED_HEIGHT; i++) {
		int byte_idx = (i / 8) * OLED_WIDTH + i;
		int bit_idx = i % 8;
		if (byte_idx < OLED_BUF_SIZE) {
			display_buffer[byte_idx] |= (1 << bit_idx);
		}
	}

	oled_write_buffer();
	LOG_INF("Test pattern displayed");
}

/* Draw animated circle */
static void oled_draw_circle(int radius, int center_x, int center_y)
{
	oled_clear_buffer();

	/* Draw circle using midpoint circle algorithm */
	int x = radius;
	int y = 0;
	int err = 0;

	while (x >= y) {
		/* Draw 8 octants */
		int points[8][2] = {
			{center_x + x, center_y + y},
			{center_x + y, center_y + x},
			{center_x - y, center_y + x},
			{center_x - x, center_y + y},
			{center_x - x, center_y - y},
			{center_x - y, center_y - x},
			{center_x + y, center_y - x},
			{center_x + x, center_y - y}
		};

		for (int i = 0; i < 8; i++) {
			int px = points[i][0];
			int py = points[i][1];
			if (px >= 0 && px < OLED_WIDTH && py >= 0 && py < OLED_HEIGHT) {
				int byte_idx = (py / 8) * OLED_WIDTH + px;
				int bit_idx = py % 8;
				if (byte_idx < OLED_BUF_SIZE) {
					display_buffer[byte_idx] |= (1 << bit_idx);
				}
			}
		}

		if (err <= 0) {
			y += 1;
			err += 2 * y + 1;
		}
		if (err > 0) {
			x -= 1;
			err -= 2 * x + 1;
		}
	}

	oled_write_buffer();
}

/* Draw a pixel into the 1bpp buffer (byte = (y/8)*WIDTH + x, bit = y%8) */
static void oled_set_pixel(int px, int py)
{
	if (px >= 0 && px < OLED_WIDTH && py >= 0 && py < OLED_HEIGHT) {
		int byte_idx = (py / 8) * OLED_WIDTH + px;
		int bit_idx = py % 8;
		if (byte_idx < OLED_BUF_SIZE) {
			display_buffer[byte_idx] |= (1 << bit_idx);
		}
	}
}

/* Power-off page: power symbol (ring with a top gap + vertical bar) */
void oled_show_power_off(void)
{
	const int cx = OLED_WIDTH / 2;
	const int cy = OLED_HEIGHT / 2 + 2;
	const int r_out = 16;
	const int r_in = 14;

	oled_clear_buffer();

	/* Ring, skipping the top segment where the bar passes through */
	for (int y = 0; y < OLED_HEIGHT; y++) {
		for (int x = 0; x < OLED_WIDTH; x++) {
			int dx = x - cx;
			int dy = y - cy;
			int dist2 = dx * dx + dy * dy;
			if (dist2 < r_in * r_in || dist2 > r_out * r_out) {
				continue;
			}
			if (dy < -r_in / 2 && dx > -6 && dx < 6) {
				continue; /* top gap */
			}
			oled_set_pixel(x, y);
		}
	}

	/* Vertical bar from above the ring into the center */
	for (int y = cy - r_out - 5; y <= cy - 4; y++) {
		oled_set_pixel(cx - 1, y);
		oled_set_pixel(cx, y);
	}

	oled_write_buffer();
}

/* Initialize OLED display */
int oled_init(void)
{
	LOG_INF("Initializing OLED display...");

	/* Get display device from devicetree */
	display_dev = DEVICE_DT_GET(DT_NODELABEL(ch1115));
	if (!device_is_ready(display_dev)) {
		LOG_ERR("Display device not ready");
		return -ENODEV;
	}

	LOG_INF("OLED display ready (%dx%d)", OLED_WIDTH, OLED_HEIGHT);

	/* Clear display on startup */
	oled_clear_buffer();
	oled_write_buffer();

	return 0;
}

/* Test 1: Clear display */
void oled_test_clear(void)
{
	LOG_INF("Test: Clear display");
	oled_clear_buffer();
	oled_write_buffer();
	k_sleep(K_SECONDS(1));
}

/* Test 2: Fill display */
void oled_test_fill(void)
{
	LOG_INF("Test: Fill display");
	oled_fill_buffer();
	oled_write_buffer();
	k_sleep(K_SECONDS(1));
}

/* Test 3: Test pattern */
void oled_test_pattern(void)
{
	LOG_INF("Test: Display test pattern");
	oled_draw_test_pattern();
	k_sleep(K_SECONDS(2));
}

/* Test 4: Animated circle (breathing effect) */
void oled_test_circle_anim(void)
{
	LOG_INF("Test: Circle animation");

	for (int i = 0; i < 20; i++) {
		int radius = 5 + (i % 10);
		oled_draw_circle(radius, OLED_WIDTH / 2, OLED_HEIGHT / 2);
		k_sleep(K_MSEC(200));
	}

	oled_clear_buffer();
	oled_write_buffer();
}

/* Test 5: Pixel manipulation test */
void oled_test_pixels(void)
{
	LOG_INF("Test: Pixel manipulation");

	oled_clear_buffer();

	/* Draw checkerboard pattern */
	for (int y = 0; y < OLED_HEIGHT; y++) {
		for (int x = 0; x < OLED_WIDTH; x++) {
			if ((x + y) % 2 == 0) {
				int byte_idx = (y / 8) * OLED_WIDTH + x;
				int bit_idx = y % 8;
				if (byte_idx < OLED_BUF_SIZE) {
					display_buffer[byte_idx] |= (1 << bit_idx);
				}
			}
		}
	}

	oled_write_buffer();
	k_sleep(K_SECONDS(2));
	oled_clear_buffer();
	oled_write_buffer();
}

/* Run all OLED tests */
void oled_run_all_tests(void)
{
	LOG_INF("Running all OLED tests...");

	oled_test_clear();
	oled_test_fill();
	oled_test_pattern();
	oled_test_circle_anim();
	oled_test_pixels();

	LOG_INF("All OLED tests completed!");
}

/* ============================================================================
 * Shell Commands
 * ============================================================================ */

/* Shell command: oled clear */
static int cmd_oled_clear(const struct shell *sh, size_t argc, char **argv)
{
	ARG_UNUSED(argc);
	ARG_UNUSED(argv);

	oled_test_clear();
	shell_print(sh, "Display cleared");

	return 0;
}

/* Shell command: oled fill */
static int cmd_oled_fill(const struct shell *sh, size_t argc, char **argv)
{
	ARG_UNUSED(argc);
	ARG_UNUSED(argv);

	oled_test_fill();
	shell_print(sh, "Display filled");

	return 0;
}

/* Shell command: oled pattern */
static int cmd_oled_pattern(const struct shell *sh, size_t argc, char **argv)
{
	ARG_UNUSED(argc);
	ARG_UNUSED(argv);

	oled_test_pattern();
	shell_print(sh, "Test pattern displayed");

	return 0;
}

/* Shell command: oled circle */
static int cmd_oled_circle(const struct shell *sh, size_t argc, char **argv)
{
	ARG_UNUSED(argc);
	ARG_UNUSED(argv);

	oled_test_circle_anim();
	shell_print(sh, "Circle animation completed");

	return 0;
}

/* Shell command: oled pixels */
static int cmd_oled_pixels(const struct shell *sh, size_t argc, char **argv)
{
	ARG_UNUSED(argc);
	ARG_UNUSED(argv);

	oled_test_pixels();
	shell_print(sh, "Pixel test completed");

	return 0;
}

/* Shell command: oled test (run all tests) */
static int cmd_oled_test(const struct shell *sh, size_t argc, char **argv)
{
	ARG_UNUSED(argc);
	ARG_UNUSED(argv);

	shell_print(sh, "Running all OLED tests...");
	oled_run_all_tests();
	shell_print(sh, "All tests completed!");

	return 0;
}

/* Shell command: oled brightness */
static int cmd_oled_brightness(const struct shell *sh, size_t argc, char **argv)
{
	int brightness;

	if (argc < 2) {
		shell_print(sh, "Usage: oled brightness <0-255>");
		return -EINVAL;
	}

	brightness = atoi(argv[1]);
	if (brightness < 0 || brightness > 255) {
		shell_print(sh, "Error: brightness must be between 0 and 255");
		return -EINVAL;
	}

	if (display_dev) {
		display_set_contrast(display_dev, (uint8_t)brightness);
		shell_print(sh, "Brightness set to %d", brightness);
	} else {
		shell_print(sh, "Error: display not initialized");
		return -ENODEV;
	}

	return 0;
}

/* Shell command table */
SHELL_STATIC_SUBCMD_SET_CREATE(sub_oled,
	/* Basic operations */
	SHELL_CMD(clear, NULL, "Clear display", cmd_oled_clear),
	SHELL_CMD(fill, NULL, "Fill display (all on)", cmd_oled_fill),
	SHELL_CMD(pattern, NULL, "Show test pattern", cmd_oled_pattern),
	SHELL_CMD(circle, NULL, "Circle animation", cmd_oled_circle),
	SHELL_CMD(pixels, NULL, "Pixel test (checkerboard)", cmd_oled_pixels),
	/* Brightness control */
	SHELL_CMD_ARG(brightness, NULL, "Set brightness (0-255)", cmd_oled_brightness, 1, 1),
	/* Run all tests */
	SHELL_CMD(test, NULL, "Run all tests", cmd_oled_test),
	SHELL_SUBCMD_SET_END
);

/* Root command: oled */
SHELL_CMD_REGISTER(oled, &sub_oled, "OLED display commands", NULL);
```

## src/oled.h
```c
/*
 * Copyright (c) 2023 Nordic Semiconductor ASA
 *
 * SPDX-License-Identifier: LicenseRef-Nordic-5-Clause
 */

#ifndef OLED_H
#define OLED_H

#include <zephyr/kernel.h>

/**
 * @brief Show the power-off page (power symbol) — visual feedback for the
 * button power-off gesture before ship mode cuts power
 */
void oled_show_power_off(void);

/**
 * @brief Initialize OLED display
 * @return 0 on success, negative errno on failure
 */
int oled_init(void);

/**
 * @brief Test 1: Clear display
 */
void oled_test_clear(void);

/**
 * @brief Test 2: Fill display
 */
void oled_test_fill(void);

/**
 * @brief Test 3: Display test pattern
 */
void oled_test_pattern(void);

/**
 * @brief Test 4: Circle animation (breathing effect)
 */
void oled_test_circle_anim(void);

/**
 * @brief Test 5: Pixel manipulation test (checkerboard)
 */
void oled_test_pixels(void);

/**
 * @brief Run all OLED tests sequentially
 */
void oled_run_all_tests(void);

#endif /* OLED_H */
```

## src/pmic.c
```c
/*
 * Copyright (c) 2023 Nordic Semiconductor ASA
 *
 * SPDX-License-Identifier: LicenseRef-Nordic-5-Clause
 */

#include <stdio.h>
#include <zephyr/kernel.h>
#include <zephyr/device.h>
#include <zephyr/drivers/gpio.h>
#include <zephyr/drivers/sensor.h>
#include <zephyr/drivers/sensor/npm13xx_charger.h>
#include <zephyr/drivers/regulator.h>
#include <zephyr/shell/shell.h>
#include <zephyr/logging/log.h>
#include "pmic.h"

LOG_MODULE_REGISTER(pmic, LOG_LEVEL_INF);

/* PMIC devices */
static const struct device *charger_dev = DEVICE_DT_GET(DT_NODELABEL(npm1300_charger));
static const struct device *pmic_gpio_dev = DEVICE_DT_GET(DT_NODELABEL(npm1300_gpio));
static const struct device *pmic_regulators = DEVICE_DT_GET(DT_NODELABEL(npm1300_regulators));

/* Charger status bitmasks (BCHGCHARGESTATUS register) */
#define CHG_STATUS_COMPLETE_MASK BIT(1)
#define CHG_STATUS_TRICKLE_MASK  BIT(2)
#define CHG_STATUS_CC_MASK       BIT(3)
#define CHG_STATUS_CV_MASK       BIT(4)

/* Voltage → SoC lookup table (same as main application) */
struct volt_soc_entry {
	uint32_t mv;
	uint8_t  soc;
};

static const struct volt_soc_entry volt_soc_table[] = {
	{ 4150, 100 },
	{ 4060,  90 },
	{ 3980,  80 },
	{ 3900,  70 },
	{ 3820,  60 },
	{ 3740,  50 },
	{ 3660,  40 },
	{ 3570,  30 },
	{ 3480,  20 },
	{ 3390,  10 },
	{ 3300,   0 },
};

static uint8_t voltage_to_soc(uint32_t mv)
{
	const int n = 10;

	if (mv >= volt_soc_table[0].mv) {
		return 100;
	}
	if (mv <= volt_soc_table[n - 1].mv) {
		return 0;
	}

	for (int i = 0; i < n - 1; i++) {
		const struct volt_soc_entry *hi = &volt_soc_table[i];
		const struct volt_soc_entry *lo = &volt_soc_table[i + 1];

		if (mv <= hi->mv && mv > lo->mv) {
			uint32_t range_mv  = hi->mv - lo->mv;
			uint32_t offset_mv = mv - lo->mv;
			uint8_t  range_soc = hi->soc - lo->soc;

			return lo->soc + (uint8_t)(offset_mv * range_soc / range_mv);
		}
	}

	return 0;
}

/* ----------------------------------------------------------------------------
 * The cycle's charge/discharge switching and the displayed % are both driven
 * by cell voltage (see voltage_to_soc() above and discharge.c). The nRF Fuel
 * Gauge was removed: its SoC was unreliable under the pulsed WiFi TX load of
 * the discharge test.
 * ------------------------------------------------------------------------- */

/* Initialize PMIC */
int pmic_init(void)
{
	int ret = 0;

	LOG_INF("Initializing PMIC (NPM1300)...");

	/* Check charger device */
	if (!device_is_ready(charger_dev)) {
		LOG_WRN("npm1300 charger not ready");
		ret = -ENODEV;
	} else {
		LOG_INF("  npm1300_charger: ready");
	}

	/* Check PMIC GPIO device */
	if (!device_is_ready(pmic_gpio_dev)) {
		LOG_WRN("npm1300_gpio not ready");
		ret = -ENODEV;
	} else {
		LOG_INF("  npm1300_gpio: ready (5 GPIOs available)");
	}

	/* Check regulators device */
	if (!device_is_ready(pmic_regulators)) {
		LOG_WRN("npm1300_regulators not ready");
		ret = -ENODEV;
	} else {
		LOG_INF("  npm1300_regulators: ready");
	}

	if (ret == 0) {
		LOG_INF("PMIC initialized successfully");
	}

	/* Initial battery reading (voltage-derived %; for the log). */
	if (device_is_ready(charger_dev)) {
		uint32_t mv = 0;
		uint8_t pct = 0;
		bool charging = false;

		if (pmic_get_battery_status(&mv, &pct, &charging) == 0) {
			LOG_INF("Battery: %u mV, %u%%, %s", mv, pct,
				charging ? "charging" : "discharging");
		}
	}

	return ret;
}

/* Get battery status */
int pmic_get_battery_status(uint32_t *voltage_mv, uint8_t *percent, bool *charging)
{
	struct sensor_value val;
	int32_t chg_status = 0;
	int ret;

	if (!device_is_ready(charger_dev)) {
		return -ENODEV;
	}

	ret = sensor_sample_fetch(charger_dev);
	if (ret < 0) {
		LOG_ERR("sensor_sample_fetch failed: %d", ret);
		return ret;
	}

	/* Read voltage */
	ret = sensor_channel_get(charger_dev, SENSOR_CHAN_GAUGE_VOLTAGE, &val);
	if (ret != 0) {
		LOG_WRN("GAUGE_VOLTAGE read failed: %d", ret);
		return ret;
	}
	*voltage_mv = (uint32_t)(val.val1 * 1000 + val.val2 / 1000);

	/* Read charging status */
	ret = sensor_channel_get(charger_dev, SENSOR_CHAN_NPM13XX_CHARGER_STATUS, &val);
	if (ret == 0) {
		chg_status = val.val1;
		*charging = (chg_status & (CHG_STATUS_TRICKLE_MASK |
					   CHG_STATUS_CC_MASK |
					   CHG_STATUS_CV_MASK)) != 0;
	} else {
		LOG_WRN("CHARGER_STATUS read failed: %d", ret);
	}

	/* SoC: voltage-derived (fuel gauge removed — unreliable under the
	 * pulsed WiFi TX load; the cycle control is voltage-based too). */
	*percent = voltage_to_soc(*voltage_mv);

	return 0;
}

/* Enable/disable charging at runtime.
 * Uses the desired-charging-current channel: 0 clears the charger enable bit
 * (CHGR_EN_CLR), non-zero sets it (CHGR_EN_SET) — see npm13xx_charger.c. */
#define CHARGE_CURRENT_MA	220	/* matches DTS current-microamp 220000 */

int pmic_charger_set(bool enable)
{
	if (!device_is_ready(charger_dev)) {
		return -ENODEV;
	}

	struct sensor_value val = {
		.val1 = enable ? CHARGE_CURRENT_MA : 0,
		.val2 = 0,
	};

	int ret = sensor_attr_set(charger_dev,
				  SENSOR_CHAN_GAUGE_DESIRED_CHARGING_CURRENT,
				  SENSOR_ATTR_CONFIGURATION, &val);
	if (ret) {
		LOG_ERR("pmic_charger_set(%d) failed: %d", enable, ret);
	}
	return ret;
}

bool pmic_is_charge_complete(void)
{
	if (!device_is_ready(charger_dev)) {
		return false;
	}

	struct sensor_value val;
	int ret = sensor_sample_fetch(charger_dev);
	if (ret < 0) {
		return false;
	}

	ret = sensor_channel_get(charger_dev, SENSOR_CHAN_NPM13XX_CHARGER_STATUS, &val);
	if (ret < 0) {
		return false;
	}

	return (val.val1 & CHG_STATUS_COMPLETE_MASK) != 0;
}

/* Get detailed charger status */
static int pmic_get_charger_status_string(char *buf, size_t len)
{
	struct sensor_value val;
	int ret;

	if (!device_is_ready(charger_dev)) {
		snprintf(buf, len, "Device not ready");
		return -ENODEV;
	}

	ret = sensor_sample_fetch(charger_dev);
	if (ret < 0) {
		snprintf(buf, len, "Sample fetch failed: %d", ret);
		return ret;
	}

	ret = sensor_channel_get(charger_dev, SENSOR_CHAN_NPM13XX_CHARGER_STATUS, &val);
	if (ret == 0) {
		int32_t status = val.val1;
		const char *state = "Unknown";

		if (status & CHG_STATUS_COMPLETE_MASK) {
			state = "Complete";
		} else if (status & CHG_STATUS_CV_MASK) {
			state = "CV (Constant Voltage)";
		} else if (status & CHG_STATUS_CC_MASK) {
			state = "CC (Constant Current)";
		} else if (status & CHG_STATUS_TRICKLE_MASK) {
			state = "Trickle";
		} else {
			state = "Not Charging";
		}

		snprintf(buf, len, "%s (0x%02x)", state, (unsigned int)status);
	} else {
		snprintf(buf, len, "Read failed: %d", ret);
	}

	return ret;
}

/* Enter ship mode (power off) */
int pmic_enter_ship_mode(void)
{
	if (!device_is_ready(pmic_regulators)) {
		LOG_ERR("npm1300 regulators not ready");
		return -ENODEV;
	}

	LOG_INF("Entering ship mode (power off)...");
	LOG_INF("  Wake up: hold button for ~3 seconds");

	/* Flush logs before ship mode */
	k_sleep(K_MSEC(100));

	return regulator_parent_ship_mode(pmic_regulators);
}

/* ============================================================================
 * Shell Commands
 * ============================================================================ */

/* Shell command: pmic status */
static int cmd_pmic_status(const struct shell *sh, size_t argc, char **argv)
{
	ARG_UNUSED(argc);
	ARG_UNUSED(argv);

	uint32_t voltage_mv;
	uint8_t percent;
	bool charging;
	char status_str[64];
	int ret;

	ret = pmic_get_battery_status(&voltage_mv, &percent, &charging);
	if (ret == 0) {
		shell_print(sh, "Battery Status:");
		shell_print(sh, "  Voltage: %u mV", voltage_mv);
		shell_print(sh, "  Level:   %u%%", percent);
		shell_print(sh, "  Charging: %s", charging ? "Yes" : "No");

		/* Get detailed charger status */
		pmic_get_charger_status_string(status_str, sizeof(status_str));
		shell_print(sh, "  Charger: %s", status_str);
	} else {
		shell_print(sh, "Error: Failed to read battery status (%d)", ret);
	}

	return ret;
}

/* Shell command: pmic monitor (continuous monitoring) */
static int cmd_pmic_monitor(const struct shell *sh, size_t argc, char **argv)
{
	uint32_t voltage_mv;
	uint8_t percent;
	bool charging;
	int iterations = 0;
	int max_iter = 10;  /* Default: 10 iterations */

	if (argc >= 2) {
		max_iter = strtol(argv[1], NULL, 10);
		if (max_iter <= 0) {
			shell_print(sh, "Usage: pmic monitor [iterations]");
			return -EINVAL;
		}
	}

	shell_print(sh, "Monitoring battery status (Ctrl+C to stop)...");

	while (iterations < max_iter) {
		if (pmic_get_battery_status(&voltage_mv, &percent, &charging) == 0) {
			shell_print(sh, "[%2d] %4u mV | %3u%% | %s",
				   iterations + 1, voltage_mv, percent,
				   charging ? "Charging" : "Discharging");
		}

		iterations++;
		k_sleep(K_SECONDS(1));
	}

	shell_print(sh, "Monitoring stopped (%d iterations)", iterations);
	return 0;
}

/* Shell command: pmic ship (enter ship mode / power off) */
static int cmd_pmic_ship(const struct shell *sh, size_t argc, char **argv)
{
	ARG_UNUSED(argc);
	ARG_UNUSED(argv);

	shell_print(sh, "Entering ship mode (power off)...");
	shell_print(sh, "Wake up: hold button for ~3 seconds");

	/* Give user time to read the message */
	k_sleep(K_SECONDS(1));

	/* Enter ship mode - this will power off the system immediately */
	pmic_enter_ship_mode();

	/* Should not reach here */
	return 0;
}

/* Shell command table */
SHELL_STATIC_SUBCMD_SET_CREATE(sub_pmic,
	SHELL_CMD(status, NULL, "Show battery and charger status", cmd_pmic_status),
	SHELL_CMD_ARG(monitor, NULL, "Monitor battery status [iterations]", cmd_pmic_monitor, 0, 1),
	SHELL_CMD(ship, NULL, "Enter ship mode (power off)", cmd_pmic_ship),
	SHELL_SUBCMD_SET_END
);

/* Root command: pmic */
SHELL_CMD_REGISTER(pmic, &sub_pmic, "PMIC (NPM1300) commands", NULL);
```

## src/pmic.h
```c
/*
 * Copyright (c) 2023 Nordic Semiconductor ASA
 *
 * SPDX-License-Identifier: LicenseRef-Nordic-5-Clause
 */

#ifndef PMIC_H
#define PMIC_H

#include <zephyr/kernel.h>

/**
 * @brief Initialize PMIC (NPM1300)
 * @return 0 on success, negative errno on failure
 */
int pmic_init(void);

/**
 * @brief Get battery status
 * @param voltage_mv Pointer to store voltage in mV
 * @param percent Pointer to store battery percentage
 * @param charging Pointer to store charging state
 * @return 0 on success, negative errno on failure
 */
int pmic_get_battery_status(uint32_t *voltage_mv, uint8_t *percent, bool *charging);

/**
 * @brief Enable or disable battery charging at runtime
 *
 * Disabling makes the device run on battery (used to force a discharge).
 * Re-enabling resumes charging if VBUS is present.
 *
 * @param enable true to charge, false to stop charging
 * @return 0 on success, negative errno on failure
 */
int pmic_charger_set(bool enable);

/**
 * @brief Check whether the charger reports charge-complete
 * @return true if the NPM1300 reports the COMPLETE status bit
 */
bool pmic_is_charge_complete(void);

/**
 * @brief Enter ship mode (power off)
 * @return 0 on success, negative errno on failure
 */
int pmic_enter_ship_mode(void);

#endif /* PMIC_H */
```

## src/wifi.c
```c
/*
 * Copyright (c) 2023 Nordic Semiconductor ASA
 *
 * SPDX-License-Identifier: LicenseRef-Nordic-5-Clause
 *
 * WiFi AP mode test module.
 */

#include <zephyr/kernel.h>
#include <zephyr/logging/log.h>
#include <zephyr/net/net_mgmt.h>
#include <zephyr/net/wifi_mgmt.h>
#include <zephyr/net/net_event.h>
#include <zephyr/net/net_if.h>
#include <zephyr/net/net_ip.h>
#include <zephyr/net/socket.h>
#include <zephyr/net/zperf.h>
#include <zephyr/net/dhcpv4_server.h>
#include <zephyr/shell/shell.h>
#include <zephyr/drivers/hwinfo.h>
#include <stdio.h>
#include <stdlib.h>
#include <string.h>
#include <net/wifi_ready.h>
#include "wifi.h"

#ifdef CONFIG_NRF70_SR_COEX
#include <coex.h>
#endif

LOG_MODULE_REGISTER(wifi, LOG_LEVEL_INF);

#define WIFI_AP_SSID_PREFIX "ClipTest_"
#define WIFI_AP_PASSWORD "12345678"
#define WIFI_AP_CHANNEL 36
#define WIFI_AP_REG_DOMAIN "US"

#define IPERF_PORT 5001
#define IPERF_PACKET_SIZE 1400
#define IPERF_DURATION_SEC 10

#define WIFI_AP_ENABLE_RETRIES 2

static bool ap_started;

bool wifi_ap_is_running(void)
{
	return ap_started;
}

static char ap_ssid[32] = "ClipTest_XXXX";
static struct net_mgmt_event_callback wifi_mgmt_cb;
static K_SEM_DEFINE(ap_enabled_sem, 0, 1);
static K_SEM_DEFINE(wifi_ready_sem, 0, 1);

static void wifi_ready_callback(bool ready)
{
	if (ready) {
		k_sem_give(&wifi_ready_sem);
	}
}

/* Scan state */
static K_SEM_DEFINE(scan_done_sem, 0, 1);
static struct wifi_scan_result scan_results[10];
static int scan_result_count;

static void generate_ap_ssid(void)
{
	uint8_t chip_id[16];
	ssize_t len = hwinfo_get_device_id(chip_id, sizeof(chip_id));

	if (len > 0) {
		uint32_t suffix = 0;
		int off = len > 4 ? len - 4 : 0;

		for (int i = 0; i < 4 && (off + i) < len; i++) {
			suffix = (suffix << 8) | chip_id[off + i];
		}
		snprintf(ap_ssid, sizeof(ap_ssid), "%s%04X",
			 WIFI_AP_SSID_PREFIX, (unsigned)(suffix & 0xFFFF));
	}
}

#ifdef CONFIG_NRF70_SR_COEX
static void wifi_coex_configure(void)
{
	bool sep = IS_ENABLED(CONFIG_COEX_SEP_ANTENNAS);
	bool ble = IS_ENABLED(CONFIG_SR_PROTOCOL_BLE);
	int ret;

	ret = nrf_wifi_coex_config_non_pta(sep, ble);
	if (ret) {
		LOG_WRN("Coex non-PTA config failed: %d", ret);
	}
	ret = nrf_wifi_coex_config_pta(NRF_WIFI_PTA_WLAN_OP_BAND_5_GHZ, sep, ble);
	if (ret) {
		LOG_WRN("Coex PTA config failed: %d", ret);
	}
	LOG_INF("Coex PTA configured (5GHz, sep=%d, ble=%d)", sep, ble);
}
#endif

static void wifi_mgmt_event_handler(struct net_mgmt_event_callback *cb,
				    uint64_t mgmt_event, struct net_if *iface)
{
	switch (mgmt_event) {
	case NET_EVENT_WIFI_AP_ENABLE_RESULT:
	{
		const struct wifi_status *status =
			(const struct wifi_status *)cb->info;
		if (status && status->status == 0) {
			printk("[WiFi] AP enabled\n");
			ap_started = true;
		} else {
			printk("[WiFi] AP enable failed: %d\n",
			       status ? status->status : -999);
		}
		k_sem_give(&ap_enabled_sem);
		break;
	}
	case NET_EVENT_WIFI_AP_DISABLE_RESULT:
		printk("[WiFi] AP disabled\n");
		ap_started = false;
		break;
	case NET_EVENT_WIFI_AP_STA_CONNECTED:
		printk("[WiFi] Station connected\n");
		break;
	case NET_EVENT_WIFI_AP_STA_DISCONNECTED:
		printk("[WiFi] Station disconnected\n");
		break;
	default:
		break;
	}
}

static void scan_result_callback(struct net_mgmt_event_callback *cb,
				 uint64_t mgmt_event, struct net_if *iface)
{
	if (mgmt_event == NET_EVENT_WIFI_SCAN_RESULT) {
		struct wifi_scan_result *result =
			(struct wifi_scan_result *)cb->info;

		if (scan_result_count < 10 && result) {
			memcpy(&scan_results[scan_result_count], result,
			       sizeof(struct wifi_scan_result));
			scan_result_count++;
			printk("Found: %s, RSSI: %d\n", result->ssid, result->rssi);
		}
	} else if (mgmt_event == NET_EVENT_WIFI_SCAN_DONE) {
		printk("Scan done, found %d networks\n", scan_result_count);
		k_sem_give(&scan_done_sem);
	}
}

static int wifi_set_reg_domain(struct net_if *iface)
{
	struct wifi_reg_domain regd = {0};
	int ret;

	regd.oper = WIFI_MGMT_SET;
	strncpy(regd.country_code, WIFI_AP_REG_DOMAIN, WIFI_COUNTRY_CODE_LEN + 1);

	ret = net_mgmt(NET_REQUEST_WIFI_REG_DOMAIN, iface, &regd, sizeof(regd));
	if (ret) {
		LOG_WRN("Reg domain failed: %d", ret);
	}

	return ret;
}

static int wifi_enable_ap(struct net_if *iface)
{
	struct wifi_connect_req_params req;
	int ret;

	memset(&req, 0, sizeof(req));
	req.ssid = (const uint8_t *)ap_ssid;
	req.ssid_length = strlen(ap_ssid);
	req.psk = (const uint8_t *)WIFI_AP_PASSWORD;
	req.psk_length = strlen(WIFI_AP_PASSWORD);
	req.channel = WIFI_AP_CHANNEL;
	req.security = WIFI_SECURITY_TYPE_PSK;
	req.mfp = WIFI_MFP_OPTIONAL;
	req.band = WIFI_FREQ_BAND_5_GHZ;

	for (int attempt = 0; attempt <= WIFI_AP_ENABLE_RETRIES; attempt++) {
		k_sem_reset(&ap_enabled_sem);

		ret = net_mgmt(NET_REQUEST_WIFI_AP_ENABLE, iface, &req, sizeof(req));
		if (ret) {
			LOG_ERR("AP enable request failed: %d (attempt %d)", ret, attempt);
			continue;
		}

		ret = k_sem_take(&ap_enabled_sem, K_SECONDS(5));
		if (ret) {
			LOG_WRN("AP enable timeout (attempt %d)", attempt);
			continue;
		}

		if (!ap_started) {
			LOG_ERR("AP enable rejected (attempt %d)", attempt);
			continue;
		}

		return 0;
	}

	return -EIO;
}

static int do_wifi_ap_start(void)
{
	struct net_if *iface;
	int ret;

	if (ap_started) {
		printk("AP already running: %s\n", ap_ssid);
		return 0;
	}

	iface = net_if_get_first_wifi();
	if (!iface) {
		printk("[WiFi] No WiFi interface\n");
		return -ENODEV;
	}

	/* Bring up interface manually (CONFIG_NRF_WIFI_IF_AUTO_START=n) */
	if (!net_if_is_admin_up(iface)) {
		printk("[WiFi] Bringing up interface\n");
		ret = net_if_up(iface);
		if (ret) {
			printk("[WiFi] net_if_up failed: %d\n", ret);
			return ret;
		}
		/* Wait for WiFi driver ready */
		ret = k_sem_take(&wifi_ready_sem, K_SECONDS(3));
		if (ret) {
			printk("[WiFi] WiFi ready timeout\n");
			net_if_down(iface);
			return -ETIMEDOUT;
		}
		printk("[WiFi] Interface ready\n");
	}

	/* Set regulatory domain */
	wifi_set_reg_domain(iface);

	/* Enable AP mode with retries */
	ret = wifi_enable_ap(iface);
	if (ret) {
		ap_started = false;
		return ret;
	}

	/* Configure static IP */
	{
		struct in_addr addr, netmask, gw;
		struct net_if_addr *ifaddr;
		struct in_addr pool_start;

		net_addr_pton(AF_INET, CONFIG_NET_CONFIG_MY_IPV4_ADDR, &addr);
		net_addr_pton(AF_INET, CONFIG_NET_CONFIG_MY_IPV4_NETMASK, &netmask);
		net_addr_pton(AF_INET, CONFIG_NET_CONFIG_MY_IPV4_GW, &gw);
		ifaddr = net_if_ipv4_addr_add(iface, &addr, NET_ADDR_MANUAL, 0);
		if (!ifaddr && !net_if_ipv4_addr_lookup(&addr, &iface)) {
			LOG_WRN("Failed to set IP address");
		}
		net_if_ipv4_set_netmask_by_addr(iface, &addr, &netmask);
		net_if_ipv4_set_gw(iface, &gw);

		pool_start.s_addr = htonl(ntohl(addr.s_addr) + 1);
		ret = net_dhcpv4_server_start(iface, &pool_start);
		if (ret && ret != -EALREADY) {
			LOG_WRN("DHCP server start failed: %d", ret);
		} else {
			printk("[WiFi] DHCP server started\n");
		}
	}

#ifdef CONFIG_NRF70_SR_COEX
	wifi_coex_configure();
#endif

	printk("[WiFi] AP started: SSID=%s ch=%d IP=%s\n",
	       ap_ssid, WIFI_AP_CHANNEL, CONFIG_NET_CONFIG_MY_IPV4_ADDR);
	printk("[WiFi] Password: %s\n", WIFI_AP_PASSWORD);
	return 0;
}

static int do_wifi_ap_stop(void)
{
	struct net_if *iface = net_if_get_first_wifi();

	if (!iface || !ap_started) {
		printk("AP not running\n");
		return 0;
	}

	net_dhcpv4_server_stop(iface);
	net_mgmt(NET_REQUEST_WIFI_AP_DISABLE, iface, NULL, 0);
	ap_started = false;
	printk("[WiFi] AP stopped\n");
	return 0;
}

static int cmd_wifi_on(const struct shell *sh, size_t argc, char **argv)
{
	ARG_UNUSED(argc);
	ARG_UNUSED(argv);
	return do_wifi_ap_start();
}

static int cmd_wifi_off(const struct shell *sh, size_t argc, char **argv)
{
	ARG_UNUSED(argc);
	ARG_UNUSED(argv);
	return do_wifi_ap_stop();
}

static int cmd_wifi_status(const struct shell *sh, size_t argc, char **argv)
{
	shell_print(sh, "WiFi AP Status:");

	if (ap_started) {
		shell_print(sh, "  SSID: %s", ap_ssid);
		shell_print(sh, "  Password: %s", WIFI_AP_PASSWORD);
		shell_print(sh, "  Channel: %d (5GHz)", WIFI_AP_CHANNEL);
		shell_print(sh, "  IP: 192.168.4.1");
	} else {
		shell_print(sh, "  State: Stopped");
		shell_print(sh, "  Use 'wifi on' to start AP");
	}

	return 0;
}

static int cmd_wifi_scan(const struct shell *sh, size_t argc, char **argv)
{
	struct net_if *iface = net_if_get_first_wifi();
	static struct net_mgmt_event_callback scan_cb;
	int ret, band = 0;

	if (!iface) {
		shell_error(sh, "No WiFi interface");
		return -ENODEV;
	}

	if (argc >= 2) {
		band = atoi(argv[1]);
		if (band < 0 || band > 2) {
			shell_print(sh, "Invalid band (0=all, 1=2.4G, 2=5G)");
			return -EINVAL;
		}
	}

	scan_result_count = 0;
	memset(scan_results, 0, sizeof(scan_results));
	k_sem_reset(&scan_done_sem);

	net_mgmt_init_event_callback(&scan_cb, scan_result_callback,
				     NET_EVENT_WIFI_SCAN_RESULT |
				     NET_EVENT_WIFI_SCAN_DONE);
	net_mgmt_add_event_callback(&scan_cb);

	struct wifi_scan_params params = {
		.scan_type = WIFI_SCAN_TYPE_ACTIVE,
		.bands = (band == 0) ? ((1 << WIFI_FREQ_BAND_2_4_GHZ) | (1 << WIFI_FREQ_BAND_5_GHZ)) :
			(band == 1) ? (1 << WIFI_FREQ_BAND_2_4_GHZ) : (1 << WIFI_FREQ_BAND_5_GHZ),
		.max_bss_cnt = 10,
	};

	shell_print(sh, "Scanning for networks...");

	ret = net_mgmt(NET_REQUEST_WIFI_SCAN, iface, &params, sizeof(params));
	if (ret) {
		shell_print(sh, "Scan failed: %d", ret);
		net_mgmt_del_event_callback(&scan_cb);
		return ret;
	}

	ret = k_sem_take(&scan_done_sem, K_SECONDS(15));
	if (ret != 0) {
		shell_print(sh, "Scan timeout");
		net_mgmt_del_event_callback(&scan_cb);
		return -ETIMEDOUT;
	}

	net_mgmt_del_event_callback(&scan_cb);

	shell_print(sh, "Found %d networks:", scan_result_count);
	shell_print(sh, "%-4s %-20s %-6s %-4s", "CH", "SSID", "RSSI", "BAND");

	for (int i = 0; i < scan_result_count; i++) {
		struct wifi_scan_result *r = &scan_results[i];
		const char *band_str = (r->band == WIFI_FREQ_BAND_2_4_GHZ) ? "2.4G" : "5G";

		char ssid[21];
		snprintf(ssid, sizeof(ssid), "%.20s", r->ssid);

		shell_print(sh, "%-4d %-20s %-6d %-4s",
			   r->channel, ssid, r->rssi, band_str);
	}

	return 0;
}

/* zperf UDP throughput test */
static K_SEM_DEFINE(zperf_done_sem, 0, 1);
static atomic_t zperf_sessions = ATOMIC_INIT(0);
static volatile bool zperf_error;
static char iperf_server_ip[32] = "192.168.4.10";

static void zperf_cb(enum zperf_status status,
		     struct zperf_results *result,
		     void *user_data)
{
	const struct shell *sh = (const struct shell *)user_data;

	switch (status) {
	case ZPERF_SESSION_STARTED:
		atomic_inc(&zperf_sessions);
		break;
	case ZPERF_SESSION_FINISHED:
		if (result && !zperf_error) {
			uint64_t bytes = (uint64_t)result->nb_packets_sent *
					 result->packet_size;
			uint64_t time_ms = result->client_time_in_us / 1000;
			uint32_t kbps = 0;

			if (result->client_time_in_us > 0) {
				kbps = (uint32_t)(
					((uint64_t)result->nb_packets_sent *
					 result->packet_size * 8ULL * 1000000ULL) /
					(result->client_time_in_us * 1024ULL));
			}
			shell_print(sh, "[WiFi iperf] pkts=%u lost=%u bytes=%llu time=%llums",
				    result->nb_packets_sent, result->nb_packets_lost,
				    bytes, time_ms);
			shell_print(sh, "[WiFi iperf] Throughput: %u kbps (%u.%03u Mbps)",
				    kbps, kbps / 1000, kbps % 1000);
		}
		if (atomic_dec(&zperf_sessions) <= 1) {
			k_sem_give(&zperf_done_sem);
		}
		break;
	case ZPERF_SESSION_ERROR:
		zperf_error = true;
		if (atomic_dec(&zperf_sessions) <= 1) {
			shell_print(sh, "[WiFi iperf] Test failed");
			k_sem_give(&zperf_done_sem);
		}
		break;
	default:
		break;
	}
}

static int cmd_udp_test(const struct shell *sh, size_t argc, char **argv)
{
	struct sockaddr_in addr;
	struct zperf_upload_params params;
	int ret;
	int duration_sec = IPERF_DURATION_SEC;
	uint32_t rate_kbps = 100000;

	if (!ap_started) {
		shell_print(sh, "WiFi AP not started. Use 'wifi on' first.");
		return -ENETDOWN;
	}

	if (argc >= 2) {
		strncpy(iperf_server_ip, argv[1], sizeof(iperf_server_ip) - 1);
	}
	if (argc >= 3) {
		duration_sec = atoi(argv[2]);
		if (duration_sec <= 0 || duration_sec > 3600) {
			shell_print(sh, "Invalid duration (1-3600 seconds)");
			return -EINVAL;
		}
	}
	if (argc >= 4) {
		rate_kbps = atoi(argv[3]);
		if (rate_kbps < 100 || rate_kbps > 1000000) {
			shell_print(sh, "Invalid rate (100-1000000 kbps)");
			return -EINVAL;
		}
	}

	memset(&addr, 0, sizeof(addr));
	addr.sin_family = AF_INET;
	addr.sin_port = htons(IPERF_PORT);
	ret = net_addr_pton(AF_INET, iperf_server_ip, &addr.sin_addr);
	if (ret != 1) {
		shell_print(sh, "Invalid IP address");
		return -EINVAL;
	}

	memset(&params, 0, sizeof(params));
	params.duration_ms = duration_sec * 1000;
	params.packet_size = IPERF_PACKET_SIZE;
	params.rate_kbps = rate_kbps;
	memcpy(&params.peer_addr, &addr, sizeof(addr));

	shell_print(sh, "UDP throughput test (iperf compatible)");
	shell_print(sh, "Target: %s:%d", iperf_server_ip, IPERF_PORT);
	shell_print(sh, "Duration: %d seconds, Rate: %u kbps", duration_sec, rate_kbps);
	shell_print(sh, "Run on PC: iperf -s -u -p 5001 -i 1");

	zperf_error = false;
	ret = zperf_udp_upload_async(&params, zperf_cb, (void *)sh);
	if (ret) {
		shell_print(sh, "Failed to start test: %d", ret);
		return ret;
	}

	ret = k_sem_take(&zperf_done_sem, K_SECONDS(duration_sec + 30));
	if (ret != 0) {
		shell_print(sh, "Test timeout");
		return -ETIMEDOUT;
	}

	return 0;
}

SHELL_STATIC_SUBCMD_SET_CREATE(sub_wifi,
	SHELL_CMD(on, NULL, "Start WiFi AP", cmd_wifi_on),
	SHELL_CMD(off, NULL, "Stop WiFi AP", cmd_wifi_off),
	SHELL_CMD(scan, NULL, "Scan for networks [band: 0=all, 1=2.4G, 2=5G]", cmd_wifi_scan),
	SHELL_CMD(status, NULL, "Show WiFi AP status", cmd_wifi_status),
	SHELL_SUBCMD_SET_END
);

SHELL_CMD_REGISTER(wifi, &sub_wifi, "WiFi AP commands", NULL);

SHELL_CMD_REGISTER(iperf, NULL, "UDP iperf throughput test [server_ip] [duration_sec] [rate_kbps]",
		   cmd_udp_test);

int wifi_init_and_connect(void)
{
	/* Generate AP SSID from chip ID */
	generate_ap_ssid();

	/* Register WiFi management events */
	net_mgmt_init_event_callback(&wifi_mgmt_cb, wifi_mgmt_event_handler,
				     NET_EVENT_WIFI_AP_ENABLE_RESULT |
				     NET_EVENT_WIFI_AP_DISABLE_RESULT |
				     NET_EVENT_WIFI_AP_STA_CONNECTED |
				     NET_EVENT_WIFI_AP_STA_DISCONNECTED);
	net_mgmt_add_event_callback(&wifi_mgmt_cb);

	/* Register WiFi ready callback */
	struct net_if *iface = net_if_get_first_wifi();
	if (iface) {
		wifi_ready_callback_t cb = { .wifi_ready_cb = wifi_ready_callback };
		register_wifi_ready_callback(cb, iface);
	}

	printk("WiFi initialized (AP mode)\n");
	printk("  SSID will be: %s\n", ap_ssid);
	printk("  Use 'wifi on' to start AP\n");

	return 0;
}

int wifi_run_test(void)
{
	int ret = wifi_init_and_connect();
	if (ret != 0) {
		return ret;
	}

	return do_wifi_ap_start();
}
```

## src/wifi.h
```c
/*
 * Copyright (c) 2023 Nordic Semiconductor ASA
 *
 * SPDX-License-Identifier: LicenseRef-Nordic-5-Clause
 */

#ifndef WIFI_H__
#define WIFI_H__

#include <zephyr/kernel.h>

/**
 * @brief Initialize WiFi AP mode
 *
 * Generates SSID from chip ID and registers event callbacks.
 * Use 'wifi on' shell command to actually start the AP.
 *
 * @return 0 on success, negative errno on failure
 */
int wifi_init_and_connect(void);

/**
 * @brief Start WiFi throughput test
 *
 * @return 0 on success, negative errno on failure
 */
int wifi_start_throughput_test(void);

/**
 * @brief Run WiFi initialization
 * This function initializes WiFi AP mode.
 *
 * @return 0 on success, negative errno on failure
 */
int wifi_run_test(void);

/**
 * @brief Enable the continuous UDP broadcast TX discharge load
 *
 * The TX thread is auto-started and waits for the AP to come up, then streams
 * UDP broadcast packets continuously (the discharge load). This call is a
 * no-op marker.
 *
 * @return 0
 */
int wifi_discharge_start(void);

/**
 * @brief Enable or disable the WiFi discharge load (and the AP)
 *
 * When enabled, the AP is brought up and the TX thread streams broadcast UDP
 * (the discharge load). When disabled, the TX thread idles and the AP is
 * brought down for minimum power (used during the charge phase).
 *
 * @param enable true to load (discharge), false to idle + AP down (charge)
 * @return 0
 */
int wifi_discharge_load_enable(bool enable);

bool wifi_ap_is_running(void);

#endif /* WIFI_H__ */
```
